## Documentation/devicetree/bindings/power/bq2477x-charger.txt
```
bq2477x charger
~~~~~~~~~~~~~~~

Required properties :
 - compatible : should contain "ti,bq2477x".
 - ti,dac-ichg : Charge current that must be programmed
 - ti,dac-v : The maximum charge voltage that must be programmed
 - ti,dac-minsv : The minimum System voltage that must be programmed
 - ti,dac-iin : The input current that must be programmed
 - ti,wdt-refresh-timeout : watch dog timer that must be programmed

Example:

	bq2477x@6a {
		compatible = "ti,bq2477x";
		reg = <0x6a>;
		ti,dac-ichg = <2240>;
		ti,dac-v = <9008>;
		ti,dac-minsv = <4608>;
		ti,dac-iin = <4992>;
		ti,wdt-refresh-timeout = <40>;
	 };
```

## Documentation/devicetree/bindings/power/power_supply_extcon.txt
```
* power_suppl_extcon devicetree bindings
This driver responsible for generating UI notification fro USB and AC
power supply.

Required properties:
- compatible : Must be "power-supply-extcon"

Required properties:
-------------------
- extcon-cables: Extcon device handles.
- extcon-cable-names: name of power supply cables. Must be:
		"usb-charger", "ta-charger", "qc2-charger", "maxim-charger",
		"fast-charger", "slow-charger", "downstream-charger"
		"apple-500ma", "apple-1a", "apple-2a", "y-cable"

Optional properties:
-------------------
- power-supply,extcon-dev: Extcon device name for the charger cables.
- power-supply,y-cable-extcon-dev: extcon device name for the y-cable.
- power-supply,default-ac-cable-connected: to set ac cable state true by default.

Example:
	psy_extcon {
		compatible = "power-supply-extcon";
		extcon-cables = <&ehanlde 0> <&ehandle 1> ...;
		extcon-cable-names = "usb-charger", "ta-charger", ...;
	};
```

## Documentation/devicetree/bindings/power_supply/bq27441_battery.txt
```
bq27441 battery
~~~~~~~~~~~~~~~~

Required properties :
 - compatible : Should contain "ti,bq27441".
 - ti,tz-name : Thermal zone name.
Optional properties :
 - ti,design-capacity : The designed battery capacity used for
   gauge's predictions. in mAh.
 - ti,design-energy : The designed battery energy. in mWh.
 - ti,taper-rate : The current threshold below which your charger
   IC is set to stop charging once it considers the battery to be
   full. in mA.
 - ti,terminate-voltage : Should be set to the minimum operating
   voltage of your system. This is the target where the gauge
   typically reports 0% capacity. in mV.
 - ti,v-at-chg-term : Voltage at charge termination. in mV.
 - ti,kernel-threshold-soc: Minimum SoC for kernel read from device.
        Bootloader jumps to kernel when SoC is more than this value.
        Driver make this SoC as 0% before reporting it to the framework.
 - ti,kernel-maximum-soc: Maximum SoC for kernel read from device.
        Kernel read maximum SoC from device for given battery. Kernel
        translate the SoC to 100% before reporting to framework if it
        reads equal/more than this value.
 - ti,enable-temp-prop:should enable temp prop if platform supports
        battery temp reading through fuel gauge chip or ADC channel.
Example:

	bq27441@55 {
		compatible = "ti,bq27441";
		ti,design-capacity = <7800>;
		ti,design-energy = <28314>;
		ti,taper-rate = <167>;
		ti,terminate-voltage = <3150>;
		ti,v-at-chg-term = <4200>;
		ti,tz-name = "battery-temp";
		ti,kernel-threshold-soc = <5>;
		ti,kernel-maximum-soc = <99>;
	};
```

## Documentation/devicetree/bindings/power_supply/lc709203f_battery.txt
```
lc709203f battery
~~~~~~~~~~~~~~~~

Required properties :
 - compatible : Should contain "onsemi,lc709203f".
 - onsemi,initial-rsoc : INITIAL_RSOC register value to be written

Optional properties:
 - onsemi,tz-name : Thermal zone name.
 - onsemi,thermistor-beta : THERMISTOR_B register value to be written
 - onsemi,appli-adjustment: adjustment appli of parameter.
 - onsemi,thermistor-adjustment: adjustment thermistor pack.

Note: The device has capabilty to read battery temp through thermistor.
This also calulate SoC based on temperature of battery. If thermistor
is not connected to this device on a given platform then the temp can be
written on the the device register to consider the battery temperature
on SoC calculation.

If battery thermistor is connected to the device's Tsense pin then following
properties are required:
	onsemi,thermistor-beta

if battery thermistor isnot connected to device and temperature is read from
other source then following properties are required:
	onsemi,tz-name

Example:

	lc709203f@0b {
		compatible = "onsemi,lc709203f";
		onsemi,tz-name = "battery-temp";
		onsemi,thermistor-beta = 0x0d34;
		onsemi,initial-rsoc = 0xAA55;
	};
```

## Documentation/devicetree/bindings/regulator/max8973-regulator.txt
```
* Maxim MAX8973 Voltage Regulator

Required properties:

- compatible:	must be one of
		"maxim,max8973",
		"maxim,max77621"
- reg:		the i2c slave address of the regulator. It should be 0x1b.

Any standard regulator properties can be used to configure the single max8973
DCDC.

Optional properties:
- maxim,externally-enable: Boolean property which tells whether EN pin control
	the output enable or not.
- maxim,dvs-gpio: DVS gpio. GPIO on which DVS pin is connected.
- maxim,dvs-default-state: Default state of the DVS pin whether it is GPIO
	control or tied to HIGH or LOW.
- maxim,control-flags: Control flags. The macros are defined on
		include/dt-bindings/regulator/max8973.h
- maxim,external-enable-gpio: GPIO number if EN pin is connected to one of
		system GPIO lines.
- maxim,sleep-on-dvs: Boolean, enable sleep control through DVS pin. When
		this property is available then property dvs-default-state
		will tell dvs pin state for active state of the rail.
- maxim,junction-temp-warning: Junction temp thrshold for which warnign
		generated. This is milli-celcius like for 120degC, it is
		120000.
- maxim,enable-active-discharge: Boolean, enable active discharge.
- maxim,enable-bias: Boolean, Enables step-down regulator bias to reduce the
		time delay to begin the output voltage rampactive discharge.
- maxim,enable-remote-sense: Boolean, Enable remote sense
- maxim,enable-falling-slew-rate: Boolean, enable falling slew rate
- maxim,enable-frequency-shift: Boolean, enable frequency shift

Example:

	max8973@1b {
		compatible = "maxim,max8973";
		reg = <0x1b>;

		regulator-min-microvolt = <935000>;
		regulator-max-microvolt = <1200000>;
		regulator-boot-on;
		regulator-always-on;
	};
```

## Documentation/devicetree/bindings/regulator/pwm-regulator.txt
```
PWM controlled regulators

Required properties:
- compatible		  : Must be "regulator-pwm".
- pwms			  : Must be pwm-list specified by pwm binding pwm.txt
- regulator-min-microvolt : Must be smallest voltage at pwm duty cycle 0%
- regulator-max-microvolt : Must be largest voltage at pwm duty cycle 100%
			    (must be above min; if equal, then use a fixed
			    regulator)

Optional properties:
- regulator-n-voltages	: number of voltages, if specified implies evenly
			  distributed duty cycle levels; must be at least 2
- voltage-time-sel	: time in microseconds of voltage transition between
                          voltage levels (specified if regulator settling time
                          is independent of voltage change; for regulators with
                          fixed slew-rate use regulator-ramp-delay property)

Control GPIOs specified according to gpio binding in gpio.txt
- enable-gpio		: GPIO to use to enable/disable the regulator
- idle-gpio		: GPIO to use to enter/exit regulator idle mode
- standby-gpio		: GPIO to use to enter/exit regulator standby mode

Any property defined as part of the pwm user binding in pwm.txt.
Any property defined as part of the core regulator binding in regulator.txt.

Example:

	pwm: pwm-controller {
		#pwm-cells = <2>;
	};

	abc_pwm_reg: pwm-regulator {
		compatible = "regulator-pwm";
		pwms = <&pwm 0 3000>;
		regulator-min-microvolt = <1000000>;
		regulator-max-microvolt = <2500000>;

		regulator-name = "vdd-abc-pwm-reg";
		regulator-enable-ramp-delay = <700>;
		regulator-boot-on;

		regulator-n-voltages = <64>;
		voltage-time-sel = <50>;
		enable-gpio = <&gpio0 21 0x0>;
		standby-gpio = <&gpio0 22 0x0>;
	};
```

## Documentation/devicetree/bindings/sound/ak4618.txt
```
AK4618 audio CODEC

This device supports only I2C.

Required properties:

  - compatible : "akm,ak4618"

  - reg : the I2C address of the device for I2C.

Pins on the device (for linking into audio routes):

  * DACOUT1
  * DACOUT2
  * DACOUT3
  * DACOUT4
  * DACOUT5
  * DACOUT6
  * IN1
  * IN2
  * IN3
  * IN4
  * IN5
  * IN6
  * MICBIAS

  - note : DACOUTs are stereo output, INs are mono input.

Example:

codec: ak4618@10 {
	compatible = "akm,ak4618";
	reg = <0x10>;
};
```

## Documentation/devicetree/bindings/sound/nvidia,tegra124-virt-alt-dam.txt
```
NVIDIA Tegra124 Virt Alt DAM (Virtual DAM)

Required properties:
- compatible : "nvidia,tegra124-virt-alt-dam"
- nvidia,ahub-dam-id : DAM id. can be 0, 1 or 2

Example:
tegra_virt_alt_dam0: dam@70302000 {
	reg = <0x70302000 0x200>;
	compatible = "nvidia,tegra124-virt-alt-dam";
	nvidia,ahub-dam-id = <0>;
	status = "okay";
};
```

## Documentation/devicetree/bindings/sound/nvidia,tegra124-virt-alt-pcm.txt
```
NVIDIA Tegra124 Virt Alt PCM (Virtual PCM Card)

Required properties:
- compatible : "nvidia,tegra124-virt-alt-pcm"
- cardname : Name of the sound card
- iommus : PPCS sw group for the smmu.
- dmas : APBMA dma handles
- dma-names : DMA channel names
- ivc_queue : ivc_queue number, which will be used for communicating
  with the audio server.
- apbif_group_id : apbif group id, which will be used by the nv_board_init
  to copy the curresponding asound state file.
- apbif_ch_num : number of APBIF channels assigned for the VM.
- apbif_ch_list : list of the APBIF channels

Example:

virt-alt-pcm {
	compatible = "nvidia,tegra124-virt-alt-pcm";
	cardname = "tegra-virt-pcm-vm2";
	iommus = <&smmu TEGRA_SWGROUP_PPCS2>;
	dmas =	<&apbdma 1>, <&apbdma 1>, <&apbdma 2>, <&apbdma 2>,
		<&apbdma 3>, <&apbdma 3>, <&apbdma 4>, <&apbdma 4>,
		<&apbdma 6>, <&apbdma 6>, <&apbdma 7>, <&apbdma 7>,
		<&apbdma 12>, <&apbdma 12>, <&apbdma 13>, <&apbdma 13>,
		<&apbdma 14>, <&apbdma 14>, <&apbdma 29>, <&apbdma 29>;
	dma-names =	"rx0", "tx0", "rx1", "tx1", "rx2", "tx2",
			"rx3", "tx3", "rx4", "tx4", "rx5", "tx5",
			"rx6", "tx6", "rx7", "tx7", "rx8", "tx8",
			"rx9", "tx9";
	status = "okay";
	ivc_queue = <&tegra_hv 25>;

	apbif_group_id = <2>;
	apbif_ch_num = <6>;
	apbif_ch_list = <4>, <5>, <6>, <7>, <8>, <9>;
};
```

## Documentation/devicetree/bindings/sound/nvidia,tegra124-virt-control.txt
```
NVIDIA Tegra124 Virt Control (Machine driver for control card)

Required properties:
- compatible : "nvidia,tegra124-virt-control"
- cardname : Name of the sound card

Example:

virt-control {
	compatible = "nvidia,tegra124-virt-control";
	cardname = "tegra-ak-ad";
	status = "okay";
};
```

## Documentation/devicetree/bindings/sound/nvidia,tegra124-virt-xbar-control.txt
```
NVIDIA Tegra124 Virt Control (Virtual XBAR control card)

Required properties:
- compatible : "nvidia,tegra124-virt-xbar-control"
- ivc_queue : ivc queue number which will be used to communicate to the audio server.
- ranges : The bus address mapping for the tegra124-virt-xbar-control and tegra124-virt-alt-dam
- #address-cells : For the sub nodes. Should be <1>;
- #size-cells : For the sud nodes. Should be <1>.

Example:
virt-xbar-control {
	compatible = "nvidia,tegra124-virt-xbar-control";
	status = "okay";
	ivc_queue = <&tegra_hv 25>;
	#address-cells = <1>;
	#size-cells = <1>;
	ranges = <0x70300000 0x0 0x70300000 0x00010000>;

};
```

## Documentation/devicetree/bindings/sound/tegra-adsp.txt
```
Tegra ADSP bindings
-------------------

The Audio DSP (ADSP) handles audio related modules.

Required properties:
 - compatible:		should be set to "nvidia,tegra210-adsp" for t210
 - reg:			should contain ADSP registers' location and length
 - nvidia,adsp_mem:	should contain Memory address and sizes of ADSP OS, APP, ARAM

Example:
	adsp {
	     compatible = "nvidia,tegra210-adsp";
	     reg = <0x0 0x702ef000 0x0 0x1000>, /* AMC */
		   <0x0 0x702ec000 0x0 0x2000>, /* AMISC */
		   <0x0 0x702ee000 0x0 0x1000>, /* ABRIDGE */
		   <0x0 0x01000000 0x0 0x6f2c0000>, /* DRAM MAP1 */
		   <0x0 0x70300000 0x0 0x8fd00000>; /* DRAM MAP2 */
	     nvidia,adsp_mem = <0x80300000 0x01000000>, /* ADSP OS */
			       <0x80B00000 0x00800000>; /* ADSP APP */
	};
```

## Documentation/devicetree/bindings/tty/serial/tegra_hv-comm.txt
```
* Tegra Hypervisor Serial emulation (tegra_hv_comm)

Required properties:
- compatible: Should be "nvidia,tegra-hv-comm"
- ivc: Should contain a tuple containing a reference to the tegra hypervisor
  node and an index of the IVC channel to use

Additional considerations:
- Each IVC frame containing serial data is processed from uninterruptible
  (atomic) context. This means that use of large frame sizes will potentially
  decrease overall system responsiveness to interrupts.
- The recommended frame size is 64 (the default configuration.)

Example:
	tegra_hv_comm {
		compatible = "nvidia,tegra-hv-comm";
		status = "okay";
		ivc = <&tegra_hv 1>;
	};
```

## Documentation/devicetree/bindings/usb/ehci-tegra.txt
```
* Nvidia USB tegra host controller

This file documents the properties used by the ehci-tegra driver.

Required properties:
- compatible: Should be similar to "nvidia,tegra132-ehci"
- reg: Specify start address and registers count details
- interrupts: Specify the interrupts IRQ info for device

Optional properties:
- nvidia,has-hostpc: Specifies if the controller supports hostpc property.
- nvidia,turn-off-vbus-on-lp0: Specify whether vbus should be powered off during LP0.
- nvidia,unaligned-dma-buf-supported: Specify if unaligned dma buffer are supported by controller.
- nvidia,power-off-on-suspend: Specifies the phy to turnoff on bus_suspend.
- nvidia,is-intf-utmi: Specify the phy type is UTMI.
- nvidia,is-intf-hsic: Specify the phy type is HSIC.
- nvidia,remote-wakeup-supported: Specifies if the controller has support for remote-wakeup.
- avdd_usb-supply: regulator supply for avdd_usb
- avdd_pll_utmip-supply: regulator supply for avdd_pll_utmi
- usb_vbus-supply: regulator supply for vbus supply
- vddio_hsic-supply: HSIC regulator supply for HSIC rail
UTMI Phy Parameters:
- nvidia,hssync-start-delay
- nvidia,idle-wait-delay
- nvidia,elastic-limit
- nvidia,term-range-adj
- nvidia,xcvr-setup
- nvidia,xcvr-lsfslew
- nvidia,xcvr-lsrslew
- nvidia,xcvr-use-fuses
- nvidia,vbus-oc-map
- nvidia,xcvr-setup-offset

Example:
	ehci@7d004000 {
		compatible = "nvidia,tegra132-ehci";
		reg = <0x0 0x7d004000 0x0 0x4000>;
		interrupts = <0 21 0x04>;
		nvidia,has-hostpc;
		nvidia,unaligned-dma-buf-supported;
		nvidia,power-off-on-suspend;
		nvidia,is-intf-utmi;
		nvidia,remote-wakeup-supported;
		nvidia,hssync-start-delay = <0>;
		nvidia,idle-wait-delay = <17>;
		nvidia,elastic-limit = <16>;
		nvidia,term-range-adj = <6>;
		nvidia,xcvr-setup = <8>;
		nvidia,xcvr-lsfslew = <2>;
		nvidia,xcvr-lsrslew = <2>;
		nvidia,xcvr-use-fuses;
		nvidia,vbus-oc-map = <5>;
		nvidia,xcvr-setup-offset = <0>;
		status = "disabled";
		avdd_usb-supply = <&as3722_gpio2>;
		avdd_pll_utmip-supply = <&dcdc_1v8>;
		usb_vbus-supply = <&usb1_usb2_vbus>;
		vddio_hsic-supply = <&as3722_ldo2>;
	};
```
