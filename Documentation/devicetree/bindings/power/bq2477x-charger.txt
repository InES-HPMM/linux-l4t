## Documentation/devicetree/bindings/usb/otg-tegra.txt
```
* Nvidia USB tegra otg controller

This file documents the properties used by the tegra-otg driver.

Required properties:
- compatible: Should be similar to "nvidia,tegra210-otg"
- reg: Specify start address and registers count details
- interrupts: Specify the interrupts IRQ info for device

Optional properties:
- turn_off_vbus_on_lp0: Specify whether vbus should be powered power during LP0.
- support_y_cable: Specify whether y-cable should be supported on that platform.
- support_pmu_vbus: Specify whether vbus detection is supported from PMU.
- vbus_extcon_dev_name: If vbus detection is supported from PMU, specify the name of extcon device which gives notifications.
- id_det_type: Specify how usb id detection type on the platform.
        TEGRA_USB_ID = 0,
        TEGRA_USB_PMU_ID = 1,
        TEGRA_USB_GPIO_ID = 2,
        TEGRA_USB_VIRTUAL_ID = 3,
- id_det_gpio: If id detection is supported through GPIO, specify the GPIO number.
- id_extcon_dev_name: If id detection is supported from PMU, specify the name of extcon device which gives notifications.
- is_xhci: Specify whether this port is taken by XUSB.

Example:
        otg@0x7d000000 {
		compatible = "nvidia,tegra210-otg";
		reg = <0x0 0x7d000000 0x0 0x4000>;
		interrupts = <0 20 0x04>;

		nvidia,support_y_cable;
                nvidia,support_pmu_vbus;
                nvidia,vbus_extcon_dev_name = "palmas-extcon";
                nvidia,id_det_type = <1>;
                nvidia,id_extcon_dev_name = "palmas-extcon";
                status = "okay";
        };
```

## Documentation/devicetree/bindings/usb/udc-tegra.txt
```
* Nvidia USB tegra device controller

This file documents the properties used by the tegra-udc driver.

Required properties:
- compatible: Should be similar to "nvidia,tegra210-udc"
- reg: Specify start address and registers count details
- interrupts: Specify the interrupts IRQ info for device

Optional properties:
- nvidia,port-otg: Specify whether given port supports otg or not.
- nvidia,charging-supported: Specify whether needs charging through USB.
- nvidia,enable-pmu-vbus-detection: Specify whether vbus detection is supported from PMU.
- nvidia,enable-aca-nv-charger-detection: Enables aca-nv-charger detection.
- nvidia,enable-aca-rid-detection: Enables ACA ID resistances detection.
- nvidia,id-detection-type: Specify how usb id detection type on the platform.
	0 - if detection is through USB controller
	1 - if detection is through PMU extcon
	2 - if enable through sysfs interface.
- nvidia,qc2-voltage: Specify the input voltage needed to support QC2.0 charger.
	0 - if input voltage is 5V
	1 - if input voltage is 9V
	2 - if input voltage is 12V
	3 - if input voltage is 20V
- nvidia,qc2-current-limit-ma: Specify the QC2.0 charger current limit in milliamperes.
- nvidia,dcp-current-limit-ma: If needs to overried standard DCP charger current limit (1.5A), specify the value in milliamperes.
- nvidia,enable-xhci-host: Specify whether this port is taken by XUSB.
- avdd_usb-supply: Specify the phandle of corresponding regulator device tree node.
- avdd_pll_utmip-supply: Specify the phandle of corresponding regulator device tree node.
- usb_bat_chg-supply: Specify the phandle of corresponding current regulator device tree node.
- extcon-cables: Specify the phandles and index of different extcon needed.
- extcon-cable-names: Specify the cable names needed from extcon.

Example:
	udc@0x7d000000 {
		compatible = "nvidia,tegra210-udc";
		reg = <0x0 0x7d000000 0x0 0x4000>;
		interrupts = <0 20 0x04>;

		nvidia,port-otg;
		nvidia,charging-supported;
		nvidia,enable-pmu-vbus-detection;
		nvidia,qc2_input_voltage = <1>;
		nvidia,qc2_current_limit_ma = <1200>;
		nvidia,dcp_current_limit_ma = <1800>;
		avdd_usb-supply = <&ldousb_reg>;
		avdd_pll_utmip-supply = <&palmas_smps8>;
		usb_bat_chg-supply = <&battery_charger>;
		status = "okay";
	};
```

## Documentation/devicetree/bindings/usb/usb-cd-tegra.txt
```
* Nvidia USB charger detection driver

This file documents the properties used by the tegra-usb-cd driver.

Required properties:
- compatible: Should be similar to "nvidia,tegra210-usb-cd"
- reg: Specify start address and registers count details

Optional properties:
- nvidia,dcp-current-limit-ma: If needs to overried standard DCP charger current limit (1.5A), specify the value in milliamperes.
- nvidia,qc2-current-limit-ma: Specify the QC2.0 charger current limit in milliamperes.
- nvidia,qc2-input-voltage: Specify the input voltage needed to support QC2.0 charger.
	0 - if input voltage is 5V
	1 - if input voltage is 9V
	2 - if input voltage is 12V
	3 - if input voltage is 20V
- nvidia,usb_bat_chg-supply: Specify the phandle of corresponding current regulator device tree node.

Example:
	usb_cd@7d000000 {
			compatible = "nvidia,tegra210-usb-cd";
			reg = <0x0 0x7009f000 0x0 0x1000>;
			nvidia,dcp-current-limit-ma = <2000>;
			#extcon-cells = <1>;
			usb_bat_chg-supply = <&charger>;
			status = "okay";
	}
```

## Documentation/devicetree/bindings/video/backlight/pwm-backlight.txt
```
pwm-backlight bindings

Required properties:
  - compatible: "pwm-backlight"
  - pwms: OF device-tree PWM specification (see PWM binding[0])
  - brightness-levels: Array of distinct brightness levels. Typically these
      are in the range from 0 to 255, but any range starting at 0 will do.
      The actual brightness level (PWM duty cycle) will be interpolated
      from these values. 0 means a 0% duty cycle (darkest/off), while the
      last value in the array represents a 100% duty cycle (brightest).
  - default-brightness-level: the default brightness level (index into the
      array defined by the "brightness-levels" property)

   The following fields are mutually exclusive  with "brightness-levels"
   and "default-brightness-level".It is used in case where levels are
   not available on the backlight device and the device can interpolate
   values.In this case the minium value that is considered is 0.

  - max-brightness: the maximum brighness value that is allowed by the
       backlight device.
  - default-brightness: the default brighness value that is allowed by the
       backlight device.

Optional properties:
  - pwm-names: a list of names for the PWM devices specified in the
               "pwms" property (see PWM binding[0])

[0]: Documentation/devicetree/bindings/pwm/pwm.txt

Examples:

	backlight {
		compatible = "pwm-backlight";
		pwms = <&pwm 0 5000000>;

		brightness-levels = <0 4 8 16 32 64 128 255>;
		default-brightness-level = <6>;
	};

	backlight {
		compatible = "pwm-backlight";
		pwms = <&pwm 1 1000000>;
		max-brightness = <255>;
		default-brightness = <224>;
	};
```

## Documentation/devicetree/bindings/video/nvidia,avp-virt.txt
```
Device-Tree bindings for tegra nvavp virtualization client driver

Required properties:
- compatible: value should be "nvidia,tegra124-avp-virt"
- iommus: should contain reference to the smmu SWID of AVPC, A9AVP and VDE
- ivc_queue: should contain reference to IVC queue number for server interaction

Note: nvavp should be disabled in the DT, when the avp-virt node is used.
Example:
	avp-virt {
		compatible = "nvidia,tegra124-avp-virt";
		iommus = <&smmu TEGRA_SWGROUP_AVPC>,
			 <&smmu TEGRA_SWGROUP_A9AVP>,
			 <&smmu TEGRA_SWGROUP_VDE>;
		ivc_queue = <&tegra_hv 21>;
	};
```

## Documentation/devicetree/bindings/video/nvidia,tegra124-dsi.txt
```
NVIDIA TEGRA124 Display Serial Interface
========================================

1) The dsi node:
 dsi node must be contained in host1x parent node. This node represents NVIDIA Tegra124 Display
 Serial Interface.

 Required properties
 - name: dsi
 - compatible: Should contain "nvidia,tegra124-dsi".
 - reg: Physical base address and length of the controller's registers.
 - nvidia,panel: phandle for panel device data.
 - nvidia,dsi-n-data-lanes: Number of DSI lanes in use. Should be one of 2, 3, 4, and 8
 - nvidia,dsi-video-burst-mode: Video mode. Write 0, 1, 2, 3, 4, 5 and 6 for TEGRA_DSI_VIDEO_NONE_BURST_MODE,
   TEGRA_DSI_VIDEO_NONE_BURST_MODE_WITH_SYNC_END, TEGRA_DSI_VIDEO_BURST_MODE_LOWEST_SPEED,
   TEGRA_DSI_VIDEO_BURST_MODE_LOW_SPEED, TEGRA_DSI_VIDEO_BURST_MODE_MEDIUM_SPEED,
   TEGRA_DSI_VIDEO_BURST_MODE_FAST_SPEED and TEGRA_DSI_VIDEO_BURST_MODE_FASTEST_SPEED,
   respectively.
 - nvidia,dsi-pixel-format: DSI pixel data format. Write 0, 1, 2, 3 for TEGRA_DSI_PIXEL_FORMAT_16BIT_P,
   TEGRA_DSI_PIXEL_FORMAT_18BIT_P, TEGRA_DSI_PIXEL_FORMAT_18BIT_NP and TEGRA_DSI_PIXEL_FORMAT_24BIT_P,
   respectively.
 - nvidia,dsi-refresh-rate: Refresh rate.
 - nvidia,dsi-virtual-channel: DSI virtual channel number. Write 0, 1, 2 and 3 for TEGRA_DSI_VIRTUAL_CHANNEL_0,
   TEGRA_DSI_VIRTUAL_CHANNEL_1, TEGRA_DSI_VIRTUAL_CHANNEL_2 and TEGRA_DSI_VIRTUAL_CHANNEL_3, respectively.
 - nvidia,dsi-instance: Should be 0 or 1: DSI controller or DSIB controller.
 - nvidia,dsi-panel-reset: Indicate if dsi output device requires hardware reset or not.
 - nvidia,dsi-power-saving-suspend: With enabled, set dsi controller ultra low power mode in suspend.
 - nvidia,dsi-video-data-type: The DSI operates in two transmission modes: video and host/command.
   Write 0, 1 for TEGRA_DSI_VIDEO_TYPE_VIDEO_MODE, TEGRA_DSI_VIDEO_TYPE_COMMAND_MODE, respectively.
 - nvidia,dsi-video-clock-mode: Control for the hs clock lane. Continuous means hs clock on all the time.
   Txonly means only hs clock active during hs transmissions. Write 0, 1 for TEGRA_DSI_VIDEO_CLOCK_CONTINUOUS,
   and TEGRA_DSI_VIDEO_CLOCK_TX_ONLY, respectively.
 - nvidia,dsi-controller-vs: DSI version. Write 0, 1 for DSI_VS_0 and DSI_VS_1, respectively. For TEGRA124,
   it should be 1.
 - nvidia,dsi-init-cmd: panel required init command sequence.
 - nvidia,dsi-n-init-cmd: command counts of init command sequence, including delay set.
 - nvidia,dsi-suspend-cmd: panel required suspend command sequence.
 - nvidia,dsi-n-suspend-cmd: command counts of suspend command sequence, including delay set.
 - nvidia,dsi-early-suspend-cmd: panel required early suspend command sequence.
 - nvidia,dsi-n-early-suspend-cmd: command counts of early suspend command sequence, including delay set.
 - nvidia,dsi-late-resume-cmd: panel required late resume command sequence.
 - nvidia,dsi-n-late-resume-cmd: command counts of late resume command sequence, including delay set.
 - nvidia,dsi-pkt-seq: custom packet sequence since some panels need non standard packet sequence.
 - nvidia,dsi-te-gpio: specifies a GPIO used for dsi panel TE signal.
 - nvidia,nvidia,dsi-ganged-type: specifies dsi ganged type. 1 for TEGRA_DSI_GANGED_SYMMETRIC_LEFT_RIGHT,
   2 for TEGRA_DSI_GANGED_SYMMETRIC_EVEN_ODD.
 - nvidia,dsi-phy-hsdexit: dsi phy timing, t_hsdexit_ns.
 - nvidia,dsi-phy-hstrail: dsi phy timing, t_hstrail_ns.
 - nvidia,dsi-phy-datzero: dsi phy timing, t_datzero_ns.
 - nvidia,dsi-phy-hsprepare: dsi phy timing, t_hsprepare_ns.
 - nvidia,dsi-phy-clktrail: dsi phy timing, t_clktrail_ns.
 - nvidia,dsi-phy-clkpost: dsi phy timing, t_clkpost_ns.
 - nvidia,dsi-phy-clkzero: dsi phy timing, t_clkzero_ns.
 - nvidia,dsi-phy-tlpx: dsi phy timing, t_tlpx_ns.
 - nvidia,dsi-phy-clkprepare: dsi phy timing, t_clkprepare_ns.
 - nvidia,dsi-phy-clkpre: dsi phy timing, t_clkpre_ns.
 - nvidia,dsi-phy-wakeup: dsi phy timing, t_wakeup_ns.
 - nvidia,dsi-phy-taget: dsi phy timing, t_taget_ns.
 - nvidia,dsi-phy-tasure: dsi phy timing, t_tasure_ns.
 - nvidia,dsi-phy-tago: dsi phy timing, t_tago_ns.

Example
	host1x {
		dsi {
			compatible = "nvidia,tegra124-dsi";
			reg = <0x54300000 0x00040000>,
			      <0x54400000 0x00040000>;
			status = "okay";
			nvidia,panel = <&panel>;
			nvidia,dsi-instance = <0>; /* 0 or 1 */
			nvidia,dsi-n-data-lanes = <4>;
			nvidia,dsi-pixel-format = <3>;
			nvidia,dsi-refresh-rate = <60>;
			nvidia,dsi-video-data-type = <0>;
			nvidia,dsi-video-clock-mode = <0>;
			nvidia,dsi-video-burst-mode = <1>;
			nvidia,dsi-controller-vs = <1>;
			nvidia,dsi-virtual-channel = <0>;
			nvidia,dsi-panel-reset = <1>;
			nvidia,dsi-power-saving-suspend = <1>;
			nvidia,dsi-init-cmd = <0x0 0x29 0x6 0x0 0x0 0xe0 0x43 0x0 0x80 0x0 0x0 0x0 0x0>,
						<0x0 0x29 0x6 0x0 0x0 0xb5 0x34 0x20 0x40 0x0 0x20 0x0 0x0>,
						<0x0 0x29 0x6 0x0 0x0 0xb6 0x04 0x74 0x0f 0x16 0x13 0x0 0x0>,
						<0x0 0x29 0x3 0x0 0x0 0xc0 0x01 0x08 0x0 0x0>,
						<0x0 0x23 0xc1 0x0 0x0>,
						<0x0 0x29 0xa 0x0 0x0 0xc3 0x0 0x09 0x10 0x02 0x0 0x66 0x20 0x13 0x0 0x0 0x0>,
						<0x0 0x29 0x6 0x0 0x0 0xc4 0x23 0x24 0x17 0x17 0x59 0x0 0x0>,
						<0x0 0x29 0xa 0x0 0x0 0xd0 0x21 0x13 0x67 0x37 0x0c 0x06 0x62 0x23 0x03 0x0 0x0>,
						<0x0 0x29 0xa 0x0 0x0 0xd1 0x32 0x13 0x66 0x37 0x02 0x06 0x62 0x23 0x03 0x0 0x0>,
						<0x0 0x29 0xa 0x0 0x0 0xd2 0x41 0x14 0x56 0x37 0x0c 0x06 0x62 0x23 0x03 0x0 0x0>,
						<0x0 0x29 0xa 0x0 0x0 0xd3 0x52 0x14 0x55 0x37 0x02 0x06 0x62 0x23 0x03 0x0 0x0>,
						<0x0 0x29 0xa 0x0 0x0 0xd4 0x41 0x14 0x56 0x37 0x0c 0x06 0x62 0x23 0x03 0x0 0x0>,
						<0x0 0x29 0xa 0x0 0x0 0xd5 0x52 0x14 0x55 0x37 0x02 0x06 0x62 0x23 0x03 0x0 0x0>,
						<0x0 0x15 0x36 0x8 0x0>,
						<0x0 0x23 0xf9 0x0 0x0>,
						<0x0 0x23 0x70 0x0 0x0>,
						<0x0 0x29 0x5 0x0 0x0 0x71 0x0 0x0 0x01 0x01 0x0 0x0>,
						<0x0 0x29 0x3 0x0 0x0 0x72 0x01 0x0e 0x0 0x0>,
						<0x0 0x29 0x4 0x0 0x0 0x73 0x34 0x52 0x0 0x0 0x0>,
						<0x0 0x29 0x4 0x0 0x0 0x74 0x05 0x0 0x06 0x0 0x0>,
						<0x0 0x29 0x4 0x0 0x0 0x75 0x03 0x0 0x07 0x0 0x0>,
						<0x0 0x29 0x4 0x0 0x0 0x76 0x07 0x0 0x06 0x0 0x0>,
						<0x0 0x29 0x9 0x0 0x0 0x77 0x3f 0x3f 0x3f 0x3f 0x3f 0x3f 0x3f 0x3f 0x0 0x0>,
						<0x0 0x29 0x9 0x0 0x0 0x78 0x40 0x40 0x40 0x40 0x40 0x40 0x40 0x40 0x0 0x0>,
						<0x0 0x29 0x9 0x0 0x0 0x79 0x40 0x40 0x40 0x40 0x40 0x40 0x40 0x40 0x0 0x0>,
						<0x0 0x29 0x9 0x0 0x0 0x7a 0x0 0x0 0x0 0x0 0x0 0x0 0x0 0x0 0x0 0x0>,
						<0x0 0x29 0x9 0x0 0x0 0x7b 0x0 0x0 0x0 0x0 0x0 0x0 0x0 0x0 0x0 0x0>,
						<0x0 0x29 0x9 0x0 0x0 0x7c 0x0 0x0 0x0 0x0 0x0 0x0 0x0 0x0 0x0 0x0>,
						<0x0 0x23 0xc2 0x2 0x0>,
						<1 20>,
						<0x0 0x23 0xc2 0x6 0x0>,
						<1 20>,
						<0x0 0x23 0xc2 0x4e 0x0>,
						<1 100>,
						<0x0 0x5 0x11 0x0 0x0>,
						<1 20>,
						<0x0 0x23 0xf9 0x80 0x0>,
						<1 20>,
						<0x0 0x5 0x29 0x0 0x0>;
			nvidia,dsi-n-init-cmd = <39>;
		};
	};
```

## Documentation/devicetree/bindings/video/nvidia,tegra124-hdmi.txt
```
NVIDIA TEGRA124 High Definition Multimedia Interface
====================================================

1) The hdmi node:
 hdmi node must be contained in host1x parent node. This node represents NVIDIA TEGRA124
 High Definition Multimedia Interface.

 Required properties
 - name: hdmi
 - compatible: Should contain "nvidia,tegra124-hdmi".
 - reg: Physical base address and length of the controller's registers.
 - interrupts: The interrupt outputs from the controller.

 Optional properties:
 - nvidia,ddc-i2c-bus: phandle of an I2C controller used for DDC EDID probing
 - nvidia,hpd-gpio: specifies a GPIO used for hotplug detection
 - nvidia,edid: supplies a binary EDID blob
 - nvidia,hotplug-report: With 1, it will have optional hotplug report callback
   which does only set DDC_SDA and DDC_SCL pull downs to be active when hotplug
   is detected, otherwise keep them disabled.

 NOTE:
 - regulator names for supply voltage, PLL and hdmi 5V source should be avdd_hdmi, avdd_hdmi_pll,
   vdd_hdmi_5v0, respectively.

Example
	host1x {
		hdmi {
			compatible = "nvidia,tegra124-hdmi";
			reg = <0x54280000 0x00040000>;
			interrupts = <0 75 0x04>;
			status = "okay";
			nvidia,ddc-i2c-bus = <&hdmi_ddc>;
			nvidia,hpd-gpio = <&gpio 111 1>;
		};
	};
```
