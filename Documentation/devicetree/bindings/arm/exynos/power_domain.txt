## Documentation/devicetree/bindings/iio/icm20628-gyro.txt
```
* Invensense ICM-20628 Gyro/Accelerometer sensor

Required properties:
- compatible: must be "invensense,mpu6xxx"
- reg: i2c address of the device. It should be 0x68 or 0x69.
- interrupt-parent:  GPIO number
- interrupts:  GPIO macro

Optional properties:
- accelerometer_disable: Setting this property to <1> will disable the
                         accelerometer.
- gyroscope_disable: Setting this property to <1> will disable the gyroscope.
- gyro_temp_disable: Setting this property to <1> will disable the gyroscope
                     temperature sensor.
  Note: To disable the entire device so that the driver unloads, all sensors
        must be disabled:
	accelerometer_disable = <1>;
	gyroscope_disable = <1>;
	gyro_temp_disable = <1>;

- accelerometer_matrix:  Orientation matrix for this device.
- gyroscope_matrix:  Orientation matrix for this device.

Example:

	icm20628@69 {
		compatible = "invensense,mpu6xxx";
                reg = <0x69>;
                interrupt-parent = <&gpio>;
                interrupts = <TEGRA_GPIO(X, 2) 0x01>;
		accelerometer_matrix = [00 ff 00 ff 00 00 00 00 ff];
		gyroscope_matrix = [00 ff 00 ff 00 00 00 00 ff];
	};
```

## Documentation/devicetree/bindings/iio/iqs253-ps.txt
```
* IQS253 proximity sensor

Required properties:
- compatible: must be "azoteq,iqs2x3"
- reg: i2c address of the device. It is one of 0x44-0x47.
- gpio_rdy: gpio to be used for i2c handshake with the sensor.

Optional properties:
- SAR_proximity_disable: Setting this property to <1> will disable the
                         SAR proximity.
- touch_proximity_disable: Setting this property to <1> will disable the
                           touch sensor.
  Note: To disable the entire device so that the driver unloads, all sensors
        must be disabled:
	SAR_proximity_disable = <1>;
	touch_proximity_disable = <1>;
- gpio_sar: gpio to be used for sending proximity event to SAR sensor.

Example:

	iqs263@44 {
		compatible = "azoteq,iqs263";
		reg = <0x44>;
		gpio_rdy = <&gpio TEGRA_GPIO(A, 1) GPIO_ACTIVE_LOW>;
		gpio_sar = <&gpio TEGRA_GPIO(V, 5) GPIO_ACTIVE_LOW>;
	};
```

## Documentation/devicetree/bindings/iio/ltr659-ps.txt
```
* LTR659 proximity sensor

Required properties:
- compatible: must be "liteon,ltrX5X"
- reg: i2c address of the device. It is 0x23.
- vdd-supply: regulator supply for chip
- vled-supply: regulator supply for led anode.

Optional properties:
- light_disable: Setting this property to <1> will disable the light sensor.
- proximity_disable: Setting this property to <1> will disable the proximity
                     sensor.
  Note: If the device supports both light and proximity, then to disable the
        entire device so that the driver unloads, all sensors must be disabled:
	light_disable = <1>;
	proximity_disable = <1>;

Example:

	ltr659@23 {
		compatible = "liteon,ltrX5X";
		reg = <0x23>;
		vdd-supply = <&palmas_smps9>;
		vled-supply = <&palmas_smps8>;
	};
```

## Documentation/devicetree/bindings/iio/meter/ina3221.txt
```
DT binding document for INA3221 iio/meter driver.

Required properties:
- compatible: Must be "ti,ina3221x".
- reg: I2C slave address of device.

- ti,trigger-config: Trigger configuration for the device in trigger mode.
- ti,continuous-config:  Device configuration in continuous mode. In this mode
	device will keep scanning the inputs.
- address-cells: Number of address in child node. Must be 1.
- size-cells: Size of address cell. Must be 0.

Optional sub-nodes:
	Device has 3 input channels and channel specific information
is provided through the child node. Each channel will have different child
node. The channel number is identified by the reg properties on each of node.
Required subnode properties:
- reg: channel number. 0 for channel 0, 1 for channel 1 and 2 for channel 2.
- ti,rail-mae: Name of the channel in string.

Optional subnode properties:
- ti,current-warning-limit-ma: Cureent warning limit for the given channel.
- ti,current-critical-limit-ma: Current critical limit for the given channel.
- ti,shunt-resistor-mohm: Shunt register in milli ohm.

Example:
	ina3221x@40 {
		compatible = "ti,ina3221x";
		reg = <0x40>;
		ti,trigger-config = <0x7003>;
		ti,continuous-config = <0x7c07>;
		#address-cells = <1>;
		#size-cells = <0>;

		channel@0 {
			reg = <0x0>;
			ti,rail-name = "VDD_BAT";
			ti,current-warning-limit-ma = <8000>;
			ti,current-critical-limit-ma = <9000>;
			ti,shunt-resistor-mohm = <1>;
		};

		channel@1 {
			reg = <0x1>;
			ti,rail-name = "VDD_CPU";
			ti,shunt-resistor-mohm = <1>;
		};

		channel@2 {
			reg = <0x2>;
			ti,rail-name = "VDD_GPU";
			ti,shunt-resistor-mohm = <1>;
		};
	};
```

## Documentation/devicetree/bindings/input/solteam-jsa1127.txt
```
* Solteam Opto Light Sensor JSA-1127

Required properties:
- compatible: should be from the list below
  "solteam-opto,jsa1127"
- reg: I2C Address
- solteam-opt,rint: resistor for adjusting integration time
- solteam-opt,integration-time: integration time
- solteam-opt,use-internal-integration-time: switch to en/disable
  using internal integration time
  0: disable
  1: enable
- solteam-opt,tint-coeff: integration time coefficient
- solteam-opt,noisy: noisy option will make driver report values in
  random variations to make ALS's applications working normally
  0: disable
  1: enable

Example:

jsa1127@39 {
	compatible = "solteam-opto,jsa1127";
	reg = <0x39>;
	solteam-opt,rint = <100>;
	solteam-opt,integration-time = <200>;
	solteam-opt,use-internal-integration-timing = <1>;
	solteam-opt,tint-coeff = <22>;
	solteam-opt,noisy = <1>;
};
```

## Documentation/devicetree/bindings/interrupt-controller/tegra-agic.txt
```
Tegra AGIC Interrupt Controller Bindings
----------------------------------------

AGIC is based on generic interrupt controller ARM IP GIC400. The
GIC-400 complies to AMBA AXI4 protocol and Version 2 of the ARM
GIC Architecture Specification. The GIC-400 implements the GICv2
Security Extension.

Required properties:
 - compatible: should be set to "nvidia,tegra210-agic"
 - reg: should contain AGIC distributor and cpu interface base
   address
 - interrupt-controller: detect this node as an interrupt-controller
 - no-gic-extension: This gic is standalone int controller and does
   not have external interrupt controller to support.
 - not-per-cpu: This gic is shared between the CPU's and the adsp and
   does not provide per-cpu interface.

Example:
	agic-controller {
		compatible = "nvidia,tegra210-agic";
		interrupt-controller;
		no-gic-extension;
		not-per-cpu;
		reg = <0x0 0x702f9000 0x0 0x2000>,
		      <0x0 0x702fa000 0x0 0x2000>;
		interrupts = <0 102 0xf04>;
	};
```

## Documentation/devicetree/bindings/media/tegra-dtv.txt
```
NVIDIA tegra dtv controller

This file documents the properties used by the tegra-dtv driver

Required properties:
- compatible : Should be similar to "nvidia,tegra210-dtv"
- reg : Should contain dtv register location and length
- nvidia,dma-request-selector : The Tegra DMA controller's phandle and
  request selector for this DTV controller.

Example:

	dtv@7000C300 {
		compatible = "nvidia,tegra210-dtv";
		reg = <0x7000c300 0x100>;
		nvidia,dma-request-selector = <11>;
	}
```

## Documentation/devicetree/bindings/mfd/max77620.txt
```
* MAX77620 Power management IC.

Required properties:
-------------------
- compatible: Must be "maxim,max77620".
- reg: I2C device address.
- interrupt-controller: MAX77620 has internal interrupt controller which takes the
  interrupt request from internal sub-blocks like RTC, regulators, GPIOs as well
  as external input.
- #interrupt-cells: Should be set to 2 for IRQ number and flags.
  The first cell is the IRQ number. IRQ numbers for different interrupt source
  of AS3722 are defined at dt-bindings/mfd/max77620.h
  The second cell is the flags, encoded as the trigger masks from binding document
	interrupts.txt, using dt-bindings/irq.

Optional properties:
-------------------

Optional submodule and their properties:
=======================================

Flexible power sequence configuration
====================================
This sub-node configure the FPS of the device. Device has 3 FPS as FPS0, FPS1
and FPS2. The FPS sub node name is "fps" and their child has register property
to reprsent FPS number.
The property for fps child nodes as:
Required properties:
	-reg: FPS number like 0, 1, 2 for FPS0, FPS1 and FPS2 respectively.
Optinal properties:
	-maxim,fps-time-period: U32 for the FPS time period.
	-maxim,fps-enable-input: FPS enable source like EN0, EN1 or SW. The
			macros are defined on dt-bindings/mfd/max77620.h for
			different enable source.
				FPS_EN_SRC_EN0 for EN0 enable source.
				FPS_EN_SRC_EN1 for En1 enable source.
				FPS_EN_SRC_SW for SW based control.
	-maxim,fps-sw-enable: Boolean, applicable if enable input is SW.
			If this property present then enable the FPS else
			disable FPS.

Example:
--------
#include <dt-bindings/mfd/max77620.h>
...
max77620@3c {
	compatible = "maxim,max77620";
	reg = <0x3c>;

	interrupt-parent = <&intc>;
	interrupts = <0 86 IRQ_TYPE_NONE>;

	interrupt-controller;
	#interrupt-cells = <2>;

	gpio-controller;
	#gpio-cells = <2>;

	fps {
		#address-cells = <1>;
		#size-cells = <0>;
		fps@0 {
			reg = <0>;
			maxim,fps-time-period = <100>;
			maxim,fps-enable-input = <FPS_EN_SRC_EN0>;
		};

		fps@1 {
			reg = <1>;
			maxim,fps-time-period = <100>;
			maxim,fps-enable-input = <FPS_EN_SRC_EN1>;
		};

		fps@2 {
			reg = <2>;
			maxim,fps-time-period = <100>;
			maxim,fps-enable-input = <FPS_EN_SRC_SW>;
		};
	};
};
```

## Documentation/devicetree/bindings/misc/tegra_usb_modem_power.txt
```
Modem Power Management Driver
-----------------------------------------------------------------------------
This driver is nvidia's Icera modem power management driver. Current actively
supported modem is Bruce. The driver controls modem power through GPIO and
supports 3 different PHY interface since T210: EHCI HSIC, XHCI HSIC, and XHCI
UTMI.

This driver uses device tree to pass all necessary platform data now.

Required properties:
- compatible: should be "nvidia,icera-i500" for now
- nvidia,boot-gpio: input GPIO for modem COLDBOOT signal
- nvidia,mdm-en-gpio: output GPIO for enabling modem
- nvidia,reset-gpio: output GPIO for hard resetting modem

Optional properties:
- nvidia,regulator: support for older platform which may need to enable
                    regulator manually. It's there for backward compatibility
- nvidia,wake-gpio: input GPIO. Define this GPIO if remote wakeup is through
                    GPIO, or remote wakeup is supported natively
- nvidia,mdm-power-report-gpio: input GPIO for modem power report
- nvidia,mdm-sar0-gpio: output GPIO for modem SAR
- nvidia,pre-boost-gpio: output GPIO for modem to control pre boost regulator
- nvidia,num-temp-sensors: integer which specifies temperature sensor count for
                    modem thermal reporting
- nvidia,use-xhci-hsic: this property is only set by bootloader SHIM layer
                    according to odmdata passed. If odmdata bit[26] is set,
                    this property will be <1> to indicate XHCI HSIC is to
                    be used as modem interface
- nvidia,phy-type: integer 0, 1, or 2, which stand for EHCI HSIC, XHCI HSIC,
                    or XHCI UTMI. This will be set automatically in driver
                    according to nvidia,use-xhci-hsic property. This is used
                    currently only for T210 loki E03 to indicate "XHCI UTMI"

Example:

With all properties defined:

    modem {
        compatible = "nvidia,icera-i500";

        /* regulator */
        nvidia,regulator = "vdd_wwan_mdm";

        /* GPIO */
        nvidia,wake-gpio = ...;
        nvidia,boot-gpio = <&gpio TEGRA_GPIO(K, 6) GPIO_ACTIVE_LOW>;
        nvidia,mdm-power-report-gpio = ...;
        nvidia,mdm-sar0-gpio = ...;
        nvidia,reset-gpio = ...;
        nvidia,mdm-en-gpio = ...;
        nvidia,pre-boost-gpio = ...;

        /* temp sensors count */
        nvidia,num-temp-sensors = <3>;

        /* USB PHY interfaces */
        nvidia,use-xhci-hsic = <1>;
        nvidia,phy-type = <1>;

        /* should be disabled by default. Bootloader will determine if this
           node will be enabled according to TNSPEC. */
        status = "disabled";
    };


Example node for a T210 ERS board:

    modem {
        compatible = "nvidia,icera-i500";
        nvidia,boot-gpio = <&gpio TEGRA_GPIO(K, 6) GPIO_ACTIVE_LOW>;
        nvidia,mdm-power-report-gpio = <&gpio TEGRA_GPIO(L, 1) GPIO_ACTIVE_LOW>;
        nvidia,reset-gpio = <&gpio TEGRA_GPIO(L, 0) GPIO_ACTIVE_LOW>;
        nvidia,mdm-en-gpio = <&gpio TEGRA_GPIO(K, 7) GPIO_ACTIVE_HIGH>;
        nvidia,num-temp-sensors = <3>;
        status = "disabled";
    };
```

## Documentation/devicetree/bindings/mmc/nvidia,tegra20-sdhci.txt
```
* NVIDIA Tegra Secure Digital Host Controller

This controller on Tegra family SoCs provides an interface for MMC, SD,
and SDIO types of memory cards.

This file documents differences between the core properties described
by mmc.txt and the properties used by the sdhci-tegra driver.

Required properties:
- compatible : Should be "nvidia,<chip>-sdhci"
- base-clk : Integer.

Optional properties:
- power-gpios : Specify GPIOs for power control
- tap-delay : Integer. Valid range 0...255.
- trim-delay : Integer. Valid range 0...31.
- ddr-trim-delay : Integer. Valid range 0...31.
- ddr-clk-limit : Integer.
- max-clk-limit : Integer.
- built-in : Boolean, indicates whether it is built-in card or not.
- mmc-ocr-mask : 0: 1V8, 1: 2V8.
- uhs_mask : Integer. For masking multiple modes OR the suitable values
	- 0x1  : MMC_UHS_MASK_SDR12
	- 0x2  :MMC_UHS_MASK_SDR25
	- 0x4  :MMC_UHS_MASK_SDR50
	- 0x8  :MMC_UHS_MASK_DDR50
	- 0x10 :MMC_UHS_MASK_SDR104
	- 0x20 :MMC_MASK_HS200
	- 0x40 :MMC_MASK_HS400

Example:

sdhci@c8000200 {
	compatible = "nvidia,tegra20-sdhci";
	reg = <0xc8000200 0x200>;
	interrupts = <47>;
	cd-gpios = <&gpio 69 0>; /* gpio PI5 */
	wp-gpios = <&gpio 57 0>; /* gpio PH1 */
	power-gpios = <&gpio 155 0>; /* gpio PT3 */
	bus-width = <8>;
	base-clk = <104000000>;
};
```
