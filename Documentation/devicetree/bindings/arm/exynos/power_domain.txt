## Documentation/devicetree/bindings/mmc/sdhci-tegra.txt
```
* Nvidia sdhci-tegra controller

This file documents differences between the core properties in mmc.txt
and the properties used by the sdhci-tegra driver.

Required properties:
- compatible: Should be "nvidia,tegra210-sdhci"
- reg: Specify start address and registers count details
- interrupts: Specify the interrupts IRQ info for device
- id: Specify device id

Optional properties:
- built-in: Add the check if the device is built-in device
- bus-width: Specify device bus width details
- tap-delay: Specify number of cycles to delay for reading data from device
- nvidia,is-ddr-tap-delay: Specifies whether the tap value for ddr mode is available or not.
- nvidia,ddr-tap-delay: Specify number of cycles to delay for reading data from device in ddr mode.
- trim-delay: Specify number of cycles to delay for writing data to device
- nvidia,is-ddr-trim-delay: Specifies whether the trim value for ddr mode is available or not.
- ddr-trim-delay: Specify number of cycles to delay for writing data to device when in DDR mode
- max-clk-limit: Specify the maximum clock limit for the device
- ddr-clk-limit: Specify the maximum clock frequency in kHz for device in DDR mode
- mmc-ocr-mask: Specify OCR register masking details
- uhs-mask: Specify modes that are masked for the device
	Mask HS200 mode: 0x20
	Mask HS400 mode: 0x40
	Mask SDR104 mode: 0x10
	Mask SDR50 mode: 0x4
	Mask DDR50 mode: 0x8
- calib-3v3-offsets and calib-1v8-offsets: Specify caliberation settings at 3.3V and at 1.8V
- auto_cal_step: Specify auto caliberation step value
- pll_source: Specify list of clock parents
- dqs-trim-delay: Specify number of cycles to delay for reading data from device when the device is enumerated in HS400, HS533 or HS667 modes and this value is applicable only for eMMC device.
- compad-vref-3v3 and compad-vref-1v8: used to control Vref_sel input of calibration pad. Should be set based on pads used for controller before starting pad drive strength calibration.
- cd-gpios: details of GPIO port used for SD card detect
- wp-gpios: details of GPIO port used for SD card write protect mode
- power-gpios: details of GPIO port used to power up SDIO card
- default-drv-type: Drive strength to select for SDIO devices is encoded as 8-bit char as follows
	Drive strength Type B: 0x0
	Drive strength Type A: 0x1
	Drive strength Type C: 0x2
	Drive strength Type D: 0x3
- disable-clock-gate: flag when set disables sdmmc clock gating
- pwrdet-support: flag when set indicates the sdmmc controller instance needs power detect bit programming for voltage switching.
- pwrdet-bit: Specify Tegra Power Management Controller power detect bit for the particular SDMMC controller instance. This field is specified only when the pwrdet-support is true
- vddio_sdmmc-supply: regulator with this name
- vddio_sd_slot-supply: regulator with this name
- update-pinctrl-settings: flag when set using pictrl apis for updating sdmmc pins
- nvidia,dll-calib-needed: DLL calibration is needed for SDMMC4 and SDMMC2 devices if they are enumerated
in HS400 mode.
- nvidia,disable-auto-cal: This flag when set will disable auto calibration
- nvidia,en-io-trim-volt: Enable IO trimmer voltage
- nvidia,is-emmc: Enable this flag for eMMC devices
- nvidia,limit-vddio-max-volt: enable this flag for sdmmc1/3 if it has Vddio 3.3v support.

Example:

	sdhci@700b0600 {
		compatible = "nvidia,tegra210-sdhci";
		reg = <0x0 0x700b0600 0x0 0x200>;
		interrupts = < 0 31 0x04 >;
		tap-delay = <4>;
		trim-delay = <3>;
		mmc-ocr-mask = <0>;
		max-clk-limit = <200000000>;
		uhs-mask = <0x20>; /* Mask HS200 */
		bus-width = <8>;
		id = <3>;
		pll_source = "pll_m", "pll_p";
		built-in;
		compad-vref-3v3 = <0x7>;
		compad-vref-1v8 = <0x7>;
		disable-clock-gate;
		calib-3v3-offsets = <0x0202>;
		calib-1v8-offsets = <0x0202>;
		vddio_sdmmc-supply = <&max77620_sd3>;
		nvidia,dll-calib-needed;
		status = "okay";
	};

	sdhci@700b0000 {
		tap-delay = <0>;
		trim-delay = <2>;
		mmc-ocr-mask = <3>;
		max-clk-limit = <136000000>;
		ddr-clk-limit = <41000000>;
		uhs-mask = <0x8>;
		bus-width = <4>;
		id = <0>;
		pll_source = "pll_m", "pll_p";
		calib-3v3-offsets = <0x7676>;
		calib-1v8-offsets = <0x7676>;
		default-drive-type = <1>;
		vddio_sd_slot-supply = <&vdd_1v8>;
		status = "okay";
	};
```

## Documentation/devicetree/bindings/net/wireless/bcmdhd/bcmdhd-wlan.txt
```
* bcmdhd-wlan devicetree bindings

This file documents the properties used by the bcmdhd-wlan driver.

Required properties:
- compatible : Must be "android,tegra-bcmdhd-wlan"

Optional properties:
- "wlan-pwr-gpio" is a gpio to power on/off wifi chip
- "wlan-rst-gpio" is a gpio to reset wifi chip
- "interrupts" is a wake on wireless gpio interrupt pin

Example:
bcmdhd_wlan {
	compatible = "android,tegra-bcmdhd-wlan";
	interrupt-parent = <&gpio>;
	interrupts = <165 0x14>;
	wlan-pwr-gpio = <&gpio TEGRA_GPIO(X, 7) 0>;
	wlan-rst-gpio = <&gpio TEGRA_GPIO(CC, 5) 0>;
};
```

## Documentation/devicetree/bindings/padctrl/padctrl-tegra210-pmc.txt
```
This describe DT binding of the pad controller driver for Tegra 210 pmc.

Required properties:
- Compatible: Must be nvidia,tegra210-pmc.
- #padcontroller-cells: Number of padctrl arguments. It must be 1.

Optional properties:
-platform-io-pad-voltage: Array of U32 data with IO rail ID and related
	volatge for that pad. Example
		platform-io-pad-voltage = <TEGRA210_PAD_GPIO IO_RAIL_VOLTAGE_1_8V
					TEGRA210_PAD_AUDIO_HV IO_RAIL_VOLTAGE_3_3V>;
		The driver intialise the io pad voltage during registration.

- platform-io-pad-power: Array of U32 data with IO rail ID and related
		power enable/disable for that pad. Example
		platform-io-pad-power = <
			TEGRA210_TEGRA_IO_PAD_GROUP_SDMMC3 TEGRA_IO_PAD_GROUP_POWER_DISABLE
			TEGRA_IO_PAD_GROUP_PEX_CTRL TEGRA_IO_PAD_GROUP_POWER_DISABLE
			TEGRA_IO_PAD_GROUP_DSI	TEGRA_IO_PAD_GROUP_POWER_ENABLE>;
The pad id is passed as the argument and this is defined as macro at
	include/dt-bindings/padctrl/tegra210-pads.h
For platform-io-pad-power, use the TEGRA_IO_PAD_GROUP_*.
For platform-io-pad-voltage, use TEGRA210_PAD_*.

Pad intitialisation through subnode:
==================================
Driver offers the pad initialisation through subnode. The subnode
under "pmc" node contains the subnode name "io-pad-defaults" which contains
child node of pads and their settings.
Following are child node name for the "io-pad-defaults" node.
	audio, audio-hv, cam, csi, csib, csic, csid, csie, csif,
	dbg, debug-nonao, dmic, dp, dsi, dsib, dsic, dsid, emmc,
	emmc2, gpio, hdmi, hsic, lvds, mipi-bias, pex-bias,
	pex-clk1, pex-clk2, pex-ctrl, sdmmc1, sdmmc3, spi, spi-hv,
	uart, usb-bias, usb0, usb1, usb2, usb3, sys, bb

Optional properties:
- nvidia,pad-name: Pad name if child node name is not used for pad name.
- nvidia,io-pad-init-voltage: Voltage value. Option will be
		IO_RAIL_VOLTAGE_1_8V, IO_RAIL_VOLTAGE_3_3V.
- nvidia,deep-power-down-enable: Boolean, Deep power down enable.
- nvidia,deep-power-down-disable: Boolean, deep power down disable.
- nvidia,io-pad-power-enable: boolean, enable io pad power i.e. deep power
		down disable.
- nvidia,io-pad-power-disable: boolean, disable io pad power i.e. deep
		power down enable.

	Property should be used for better readbility and not clnflict with
	other properties.

	pmc {
		::::
		io-pad-defaults {
			pex-clk1 {
				nvidia,deep-power-down-enable;
			};

			gpio {
				nvidia,io-pad-init-voltage = <IO_RAIL_VOLTAGE_1_8V>;
			};
			:::
		};
	};


Example: SDMMC1 pad is 6 and SDMMC3 is 7.

	tegra_pmc: pmc@7000e400 {
		compatible = "nvidia,tegra210-pmc";
		reg = <0x0 0x7000e400 0x0 0x400>;
		#padcontroller-cells = <1>;
		status = "disabled";
		platform-io-pad-voltage = <TEGRA210_PAD_GPIO IO_RAIL_VOLTAGE_1_8V
					TEGRA210_PAD_AUDIO_HV IO_RAIL_VOLTAGE_3_3V>;
	};


	sdhci@700b0400 {
		compatible = "nvidia,tegra210-sdhci";
		::::
		pad-controllers = <&tegra_pmc TEGRA210_PAD_SDMMC3>;
		pad-names = "sdmmc";
		::::
	};
```

## Documentation/devicetree/bindings/pci/nvidia,tegra124-pcie.txt
```
NVIDIA Tegra PCIe controller

Required properties:
- compatible: should be
	"nvidia,tegra124-pcie"
  Details:
  nvidia,tegra124-pcie:
	T124 uses 2 PCIE controllers with 5 lanes in X4_X1 and X2_X1 xbar modes

- nvidia,port0_status: Current board supports port0 slot support status
- nvidia,port1_status: Current board supports port1 slot support status
- nvidia,hot-plug-gpio: Generic Tegra GPIO number used for hotplug event
- nvidia,wake-gpio: Part of connector, used for wake up from LP0
- nvidia,x1-slot-gpio: Board specific, used to enable port1 slot.

Example:

SoC DTSI:
	pcie-controller {
		compatible = "nvidia,tegra124-pcie";
		status = "disabled";
	};

Board DTS:
	pcie-controller {
		nvidia,port0_status = <1>;
		nvidia,port1_status = <1>;
		nvidia,hot-plug-gpio = <&gpio TEGRA_GPIO(O, 1) 0>;
		nvidia,wake-gpio = <&gpio TEGRA_GPIO(DD, 3) 0>;
		nvidia,x1-slot-gpio = <&tca6416 8 0>; /* TCA6416_GPIO(8) */
		status = "okay";
        };
```

## Documentation/devicetree/bindings/platform/tegra/panel-cy8c.txt
```
CY8C microcontroller driven panel power sequence driver

Required properties:
- compatible : should be "nvidia,cy8c_panel".

Sub-node properties:
- reg : i2c regmap address (app firmware)
- enable-gpio : gpio used to enable uC operations.
	This gpio must remain high for as long as the
	panel is enabled. It may be deasserted after
	the panel is disabled.
- max-xfer-size : minimum of maximum Tegra and maximum
	cy8c I2C transfer chunk sizes

Examples:
	i2c@7000c000 {
		cy8c_panel@09 {
			compatible = "nvidia,cy8c_panel";
			reg = <0x09>;
			enable-gpio = <&gpio TEGRA_GPIO(K, 1) 0>;
			max-xfer-sz = <64>;
			#address-cells = <1>;
			#size-cells = <0>;
		};
	};
};
```

## Documentation/devicetree/bindings/power/bq2419x-charger.txt
```
* bq2419x charger devicetree bindings

Required properties:
- compatible : Should be from the list
  ti,bq2419x
                          to be drawn by the charger from the power source.

Required nodes:
- regulators: There must a regulator subnode each for the following purposes:
              (1) Setting battery charging current.
              (2) Enabling current supply to vbus (To enable otg mode)
              Each of these regulator nodes must have atleast one consumer
              subnode which in turn must have certain mandatory properties
              supplied. To know about these mandatory properties and more about
              consumer subnodes, please refer
              Documentation/devicetree/bindings/regulator/regulator.txt

Additional properties to be added to charger regulator subnode:

Required properties:
- auto-recharge-time      : Time interval in seconds after which the charging
                            should be restarted after the charging is complete.

Optional properties:
- watchdog-timeout        : Watchdog timer expiry timeout value in seconds.
                            When not specified, watchdog timer functionality
                            will be disabled.
- rtc-alarm-time          : Time setting in seconds for the rtc alarm timer
                            which wakes the board up for charging after shutdown.

Subnode properties:
==================
There is two optional subnodes, vbus and charger.

vbus properties:
================
otg-iusb-gpio-isub-gpio: The GPIO which is connected to OTG/IUSB pin.


Example
bq2419x: bq2419x@6b {
	compatible = "ti,bq2419x";
	reg = <0x6b>;
	charging-term-current-mA = <100>;
	charger {
			regulator-name = "batt_regulator";
			regulator-max-microamp = <3000>;
			watchdog-timeout = <40>;
			rtc-alarm-time = <3600>;
			auto-recharge-time = <1800>;
			consumers {
				c1 {
					regulator-consumer-supply = "usb_bat_chg";
					regulator-consumer-device = "tegra-udc.0";
				};
			};
	};
	vbus {
		regulator-name = "vbus_regulator";
		consumers {
			c1 {
				regulator-consumer-supply = "usb_vbus";
				regulator-consumer-device = "tegra-ehci.0";
			};

			c2 {
				regulator-consumer-supply = "usb_vbus";
				regulator-consumer-device = "tegra-otg";
			};
		};
	};
};
```
