## Documentation/devicetree/bindings/arm/exynos/power_domain.txt
```
* Samsung Exynos Power Domains

Exynos processors include support for multiple power domains which are used
to gate power to one or more peripherals on the processor.

Required Properties:
- compatible: should be one of the following.
    * samsung,exynos4210-pd - for exynos4210 type power domain.
- reg: physical base address of the controller and length of memory mapped
    region.
- #power-domain-cells: number of cells in power domain specifier;
    must be 0.

Node of a device using power domains must have a samsung,power-domain property
defined with a phandle to respective power domain.

Example:

	lcd0: power-domain-lcd0 {
		compatible = "samsung,exynos4210-pd";
		reg = <0x10023C00 0x10>;
		#power-domain-cells = <0>;
	};

Example of the node using power domain:

	mfc_pd: power-domain@10044060 {
		compatible = "samsung,exynos4210-pd";
		reg = <0x10044060 0x20>;
		clocks = <&clock CLK_FIN_PLL>, <&clock CLK_MOUT_SW_ACLK333>,
			<&clock CLK_MOUT_USER_ACLK333>;
		clock-names = "oscclk", "pclk0", "clk0";
		#power-domain-cells = <0>;
	};

See Documentation/devicetree/bindings/power/power_domain.txt for description
of consumer-side bindings.
```

## Documentation/devicetree/bindings/arm/tegra/nvidia,tegra-dfll.txt
```
NVIDIA Tegra DFLL clock source data in the SoC DTS file:

Required properties:
- compatible : Must be one of the following
	"nvidia,tegra124-dfll".
	"nvidia,tegra148-dfll".
	"nvidia,tegra114-dfll",
- reg : Must contain the starting physical address and length for the DFLL's
  MMIO register space including the DFLL-to-I2C controller interface and the
  DFLL's I2C controller.
- out-clock-name : Must contain a "dfll_cpu" string, name of the DFLL output
  clock.

Optional properties:
- status : device availability -- managed by the DT integration code.
  Should be set to "disabled" in the SoC DTS file.

Example:

dfll@70110000 {
        compatible = "nvidia,tegra124-dfll";
        reg = <0x70110000 0x400>;
        out-clock-name = "dfll_cpu";
        status = "disabled";
};


NVIDIA Tegra DFLL clock source data in the board DTS file

Required properties:
- board-params : phandle pointing to the board-specific configuration data
  for this DFLL instance.
- i2c-pmic-integration : phandle pointing to the integration data for
  PMIC controlled by this DFLL instance via I2C interface.
Note that after future addition of device tree support for PMIC controlled via
PWM interface, this property become optional and mutually exclusive with
pwm-pmic-integration.

Optional properties:
- i2c-quiet-output-workaround : If the DFLL IP block version implemented on
  this SoC requires the I2C output to the PMIC to be quiesced before disabling
  it, this property should be set.
- monitor-data-new-workaround : If the DFLL IP block version implemented on
  this SoC may erroneously clear DFLL monitor data new indicator, this property
  should be set.
- dynamic-output-lut-workaround : If the DFLL IP block version implemented on
  this SoC does not support dynamic change of DFLL output limits register
  fields, this property should be set.

- status : device availability -- managed by the DT integration code.
  Should be set to "okay" if the DFLL is to be used on this board type.

Example:

dfll@70110000 {
        board-params = <&{/cpu_dfll_board_params}>;
        i2c-pmic-integration = <&{/cpu_dfll_pmic_integration}>;
        status = "okay";
};


DFLL board params node in the board DTS file

Required properties:
- sample-rate : control loop sample rate (in Hz).
- cf : I2C: duration to force the PMIC voltage after frequency change.
- cg : loop gain (signed) - determined during board characterization.
- ci : loop integral gain selector.
- droop-cut-value : DFLL output clock throttle setting at voltage droop event.
- droop-restore-ramp : DFLL clock recovery rate after a voltage droop event.
- scale-out-ramp : DFLL clock output scaling ramp rate.

Optional properties:
- cg-scale : if present, divide loop gain by 8 (see 'cg' above).

- fixed-output-forcing : force PMIC voltage during req change for a fixed time.
- auto-output-forcing : force PMIC voltage during req change for a dynamic time.
- no-output-forcing : don't force PMIC voltage output during request change.
Note that one and only one of 'fixed-output-forcing', or 'auto-output-forcing',
or 'no-output-forcing' must be specified.

Example:

cpu_dfll_board_params {
        sample-rate = <12500>;
        fixed-output-forcing;
        cf = <10>;
        ci = <0>;
        cg = <2>;
        droop-cut-value = <0xf>;
        droop-restore-ramp = <0x0>;
        scale-out-ramp = <0x0>;
};


DFLL I2C PMIC integration node in the board DTS file

Required properties:
- pmic-i2c-address : PMIC I2C bus address.
- pmic-i2c-voltage-register : internal PMIC address of the select-output-voltage
  register (vsel register) for the rail that supplies the DFLL.
- sel-slope : slope coefficient for linear conversion of selector values exposed
  by regulator framework into PMIC vsel register settings.
- i2c-fs-rate : I2C bus rate in Hz, in FS mode.

Optional properties:
- i2c-10-bit-addresses : PMIC requires a 10-bit I2C address.
- i2c-hs-rate : use HS I2C bus mode to communicate with the PMIC, at this rate
  in Hz.
- i2c-hs-master-code : I2C master code to use - only applies in HS mode; must
  be set if i2c-hs-rate is set, ignored otherwise.
- sel-offset : offset coefficient for linear conversion of selector values
  exposed by regulator framework into PMIC vsel register settings (offset zero,
  if not present).
- pmic-undershoot-gb : PMIC undershoot guard-band in mV (zero, if not present).

Example:

cpu_dfll_pmic_integration {
        pmic-i2c-address = <0xb0>;
        pmic-i2c-voltage-register = <0x23>;
        i2c-fs-rate = <400000>;
        sel-conversion-slope = <1>;
        pmic-undershoot-gb = <100>;
};
```

## Documentation/devicetree/bindings/arm/tegra/nvidia,tegra-dvfs-rail.txt
```
NVIDIA Tegra DVFS rail data in the board DTS file:

Required properties:
- compatible : Must be one of the following
	"nvidia,tegra210-dvfs-rail"

- vdd_cpu-supply : Must contain phandle pointing to the regulator for CPU rail.
- vdd_gpu-supply : Must contain phandle pointing to the regulator for GPU rail.
- vdd_core-supply : Must contain phandle pointing to the regulator for SoC rail.

One and only one of the above properties must be specified for each rail node.

Optional properties:
- vdd_cpu_dfll-supply : Must contain phandle pointing to the regulator for CPU
rail in DFLL closed loop mode. This property is required if 'vdd_cpu-supply'
property is pointing to fixed regulator node. Otherwise, it is ignored.

-reg : Can be any number but same as used in the node name

DVFS rail nodes can be placed at root, or included into dvfs-rails parent node.
In the latter case "reg" property is required, and parent node must be specified
as simple bus with the following required properties:

- compatible : Must be "simple-bus"
- #address-cells: Must be 1.
- #size-cells: Must be 0.

Examples:

dvfs_rails {
	compatible = "simple-bus";
	#address-cells = <1>;
	#size-cells = <0>;

	vdd-cpu-rail@0 {
		reg = <0>;
		compatible = "nvidia,tegra210-dvfs-rail";
		vdd_cpu-supply = <&pmicxxx_sd0>;
	};

	vdd-core-rail@1 {
		reg = <1>;
		compatible = "nvidia,tegra210-dvfs-rail";
		vdd_core-supply = <&pmicxxx_sd1>;
	};

	vdd-gpu-rail@2 {
		reg = <2>;
		compatible = "nvidia,tegra210-dvfs-rail";
		vdd_gpu-supply = <&pmicxxx_sd6>;
	};
};

dvfs_rails {
	compatible = "simple-bus";
	#address-cells = <1>;
	#size-cells = <0>;

	vdd-cpu-rail@0 {
		reg = <0>;
		compatible = "nvidia,tegra210-dvfs-rail";
		vdd_cpu-supply = <&cpu_fixed_reg>;
		vdd_cpu_dfll-supply = <&cpu_pwm_reg>;
	};

	vdd-core-rail@1 {
		reg = <1>;
	....
};
```

## Documentation/devicetree/bindings/ata/tegra-sata.txt
```
* Nvidia Tegra124 AHCI SATA Controller

SATA nodes are defined to describe on-chip Serial ATA controllers.
Each SATA controller should have its own node.

Required properties:
- compatible            : compatible list, contains "nvidia,tegra124-ahci-sata"
- interrupts            : <interrupt mapping for SATA IRQ>
- reg                   : <registers mapping>
- nvidia,gen1-amp       : AMP feild of sata PHY control Register
                          T_SATA0_CHX_PHY_CTRL1_GEN1
- nvidia,gen2-amp       : AMP feild of sata PHY control Register
                          T_SATA0_CHX_PHY_CTRL1_GEN2
- nvidia,gen1-peak      : PEAK feild of sata PHY control Register
                          T_SATA0_CHX_PHY_CTRL1_GEN1
- nvidia,gen2-peak      : PEAK feild of sata PHY control Register
                          T_SATA0_CHX_PHY_CTRL1_GEN2
- nvidia,l2p_fifo_depth : T_SATA0_FIFO_L2P_FIFO_DEPTH feild of
                          T_SATA0_FIFO register
Example:
        sata@70020000 {
                compatible = "nvidia,tegra124-ahci-sata";
                reg = <0x0 0x70021000 0x0 0x00001000>,
                        <0x0 0x70027000 0x0 0x00002000>;
                interrupts = <0 23 0x04>;
                iommus = <&smmu TEGRA_SWGROUP_SATA2>;
                status = "disabled";
                vidia,gen1-amp = /bits/8 <0x12>;
                nvidia,gen2-amp = /bits/8 <0x18>;
                nvidia,gen1-peak = /bits/8 <0x4>;
                nvidia,gen2-peak = /bits/8 <0xA>;
                nvidia,l2p_fifo_depth = /bits/8 <0x7>;
        };
```

## Documentation/devicetree/bindings/edp/nvidia,tegra124-sysedp-dynamic-capping.txt
```
System-EDP Consumers:

Required properties:
- compatible: "nvidia,tegra124-sysedp-dynamic-capping"
- nvidia,corecap: This is an array of tegra_sysedp_corecap structs. The order
  and contents of each corecap line refers to a unsigned int value inside the
  tegra_sysedp_corecap struct.  Here's the order of the values expected per
  line of data:
    - AP power (milliwatts): Power required by the AP+DRAM when the CPU power
	  and GPU and EMC frequencies are capped.
	- CPU Priority CPU Max Power (milliwatts): Maximum power given to the CPU
	  when the CPU has the priority.
	- CPU Priority GPU Max Frequency (kHz): Maximum GPU frequency allowed when
	  the CPU has the priority.
	- CPU Priority EMC Max Frequency (kHz): Maximum EMC frequency allowed when
	  the CPU has the priority.
	- GPU Priority CPU Max Power (milliwatts): Maximum power given to the CPU
	  when the GPU has the priority.
	- GPU Priority GPU Max Frequency (kHz): Maximum GPU frequency allowed when
	  the GPU has the priority.
	- GPU Priority EMC Max Frequency (kHz): Maximum EMC frequency allowed when
	  the GPU has the priority.
	- Throttle power (milliwatts): The amount of power returned to the system
	  when the SOC_THERM OC signal throttles the CPU and GPU frequencies.
	  This is the amount of power with 100% throttle depth.
  Note that the order of AP Power must start with the smallest power and
  should increase for each entry.
- nvidia,core_gain: The percentage of gain applied to the AP+DRAM budget power.
  A value of 100 means to multiply by 1.0.
- nvidia,init_req_watts defines the initial AP+DRAM budget before the
  sysedp_dynamic_capping gets a calculated budget from the sysedp module.
- nvidia,throttle_depth: The percentage of gain applied to the throttle power.
  A value of 100 means to multiply by 1.0.  Expected values are between 0-100%.
  This value should be matched to the HW SOC_THERM throttle depth choice.
- nvidia,cap_method: The calculation to use when determining which corecap
  entry is associated with the AP+DRAM budget. For systems with voltage
  comparators, the value should be 3.  For systems without voltage comparators,
  but with modem overcurrent signals, the value should be 2.  For all other
  systems, the value should be set to 1.

Example:
	sysedp-dynamic-capping {
		compatible = "nvidia,tegra124-sysedp-dynamic-capping";
		nvidia,corecap = <
		   5000   2000 100000 933000   2000 100000 933000    500
		  10000   7000 100000 933000   3500 400000 933000   2000
		  15000  10000 200000 933000   4000 600000 933000   4000
		  20000  10000 500000 933000   5000 700000 933000   8000
		>;
		nvidia,core_gain = <100>;
		nvidia,init_req_watts = <20000>;
		nvidia,throttle_depth = <75>;
		nvidia,cap_method = <3>;
	};
```

## Documentation/devicetree/bindings/iio/ak8963c-compass.txt
```
* AKM 8963C Compass sensor

Required properties:
- compatible: must be "ak,ak89xx"
- reg: i2c address of the device. It should be 0x0C or 0x0D.

Optional properties:
- magnetic_field_disable: Setting this property to <1> will disable this
                          driver: The driver will unload after this property is
			  detected.
- magnetic_field_matrix:  Orientation matrix for this device.

Example:

	ak8963c@0d {
		compatible = "ak,ak89xx";
                reg = <0x0d>;
                magnetic_field_matrix = [ff 00 00 00 ff 00 00 00 01];
        };
```

## Documentation/devicetree/bindings/iio/bh1730fvc-als.txt
```
* ROHM BH1730FVC ambient light sensor

nvs_ drivers use the NVidia Sensor (NVS) framework.
See the nvs.txt documentation for NVS DT capabilities.

Required properties:
- compatible: must be "rohm,bh1730fvc"
- reg: i2c address of the device. It should be 0x29.

Optional properties:
- status: set to "ok" or "okay" for normal operation.  Set to anything else
	  to unload the driver without ever communicating with the device.
  Note: The "anything else" above is typically "disabled".
	Since the driver will unload without communicating with the device, the
	device will be left in its POR state.
- vdd-supply: regulator supply for the chip vcc
- vid-supply: regulator supply for the chip dvi
  Note: This is required if the driver is to control the regulator.


Example:
                bh1730fvc@29 {
                        compatible = "rohm,bh1730fvc";
                        reg = <0x29>;
                };
```

## Documentation/devicetree/bindings/iio/bmp280-pressure.txt
```
* Bosch BMP-280 pressure sensor

Required properties:
- compatible: must be "bmp,bmpX80"
- reg: i2c address of the device. It should be 0x76 or 0x77.

Optional properties:
- pressure_disable: Setting this property to <1> will disable this driver:
                    The driver will unload after this property is detected.
- nvi_config: This configures the device's I2C connection.
              The string options are: auto
	                              mpu
	                              host
	      auto = the driver will auto detect the connection.
	      mpu = the device is connected to an Invensense auxilary bus.
	      host = the device is connected to the host AP.
	      If this property is not defined, auto will be used.

Example:

	bmp280@77 {
                compatible = "bmp,bmpX80";
                reg = <0x77>;
        };
```

## Documentation/devicetree/bindings/iio/cm3217-als.txt
```
* Capella CM3217 ambient light sensor

Required properties:
- compatible: must be "capella,cm3217"
- reg: i2c address of the device. It should be 0x10.
- vdd-supply: regulator supply for the chip

Optional properties:
- light_disable: Setting this property to <1> will disable this driver:
                 The driver will unload after this property is detected.

Example:
	cm3217@10 {
		compatible = "capella,cm3217";
		reg = <0x10>;
		vdd-supply = <&palmas_smps9>;
	};
```
