## arch/arm64/configs/tegra_t132ref_mods_defconfig
```kconfig
CONFIG_NO_HZ=y
CONFIG_HIGH_RES_TIMERS=y
CONFIG_IKCONFIG=y
CONFIG_IKCONFIG_PROC=y
CONFIG_CGROUPS=y
CONFIG_CGROUP_DEBUG=y
CONFIG_CGROUP_FREEZER=y
CONFIG_CGROUP_CPUACCT=y
CONFIG_RESOURCE_COUNTERS=y
CONFIG_CGROUP_SCHED=y
CONFIG_RT_GROUP_SCHED=y
CONFIG_BLK_DEV_INITRD=y
# CONFIG_ELF_CORE is not set
CONFIG_EMBEDDED=y
CONFIG_SLAB=y
CONFIG_PROFILING=y
CONFIG_MODULES=y
CONFIG_MODULE_UNLOAD=y
CONFIG_MODULE_FORCE_UNLOAD=y
# CONFIG_BLK_DEV_BSG is not set
CONFIG_PARTITION_ADVANCED=y
# CONFIG_IOSCHED_DEADLINE is not set
# CONFIG_IOSCHED_CFQ is not set
CONFIG_ARCH_TEGRA=y
CONFIG_PM_DEVFREQ=y
CONFIG_ARCH_TEGRA_12x_SOC=y
CONFIG_TEGRA_NO_CARVEOUT=y
CONFIG_MACH_ARDBEG=y
CONFIG_MACH_LOKI=y
CONFIG_MACH_LAGUNA=y
# CONFIG_TEGRA_GPU_DVFS is not set
# CONFIG_TEGRA_GK20A is not set
CONFIG_TEGRA_CLOCK_DEBUG_WRITE=y
CONFIG_TEGRA_CLOCK_DEBUG_FUNC=y
CONFIG_TEGRA_GADGET_BOOST_CPU_FREQ=1400
CONFIG_TEGRA_EHCI_BOOST_CPU_FREQ=800
CONFIG_TEGRA_DYNAMIC_PWRDET=y
CONFIG_TEGRA_WAKEUP_MONITOR=y
CONFIG_TEGRA_PREPOWER_WIFI=y
CONFIG_TEGRA_PLLM_SCALED=y
CONFIG_TEGRA_MC_DOMAINS=y
CONFIG_ARCH_TEGRA_13x_SOC=y
CONFIG_MACH_T132REF=y
CONFIG_PCI_TEGRA=y
CONFIG_PCIEPORTBUS=y
CONFIG_SMP=y
CONFIG_NR_CPUS=2
CONFIG_PREEMPT=y
CONFIG_COMPAT=y
CONFIG_PM_AUTOSLEEP=y
CONFIG_PM_WAKELOCKS=y
CONFIG_PM_RUNTIME=y
CONFIG_SUSPEND_TIME=y
CONFIG_CPU_IDLE=y
# CONFIG_FIRMWARE_IN_KERNEL is not set
CONFIG_PLATFORM_ENABLE_IOMMU=y
CONFIG_BLK_DEV_LOOP=y
CONFIG_AD525X_DPOT=y
CONFIG_AD525X_DPOT_I2C=y
CONFIG_APDS9802ALS=y
CONFIG_SENSORS_NCT1008=y
CONFIG_UID_STAT=y
CONFIG_TEGRA_CRYPTO_DEV=y
CONFIG_MAX1749_VIBRATOR=y
CONFIG_THERM_EST=y
CONFIG_FAN_THERM_EST=y
CONFIG_BLUEDROID_PM=y
CONFIG_C2PORT=y
CONFIG_EEPROM_AT24=y
CONFIG_SCSI=y
CONFIG_BLK_DEV_SD=y
CONFIG_BLK_DEV_SR=y
CONFIG_BLK_DEV_SR_VENDOR=y
CONFIG_CHR_DEV_SG=y
CONFIG_SCSI_MULTI_LUN=y
CONFIG_INPUT_FF_MEMLESS=y
# CONFIG_INPUT_MOUSEDEV is not set
CONFIG_INPUT_JOYDEV=y
CONFIG_INPUT_EVDEV=y
CONFIG_INPUT_KEYRESET=y
# CONFIG_KEYBOARD_ATKBD is not set
CONFIG_KEYBOARD_GPIO=y
CONFIG_KEYBOARD_TEGRA=y
# CONFIG_INPUT_MOUSE is not set
CONFIG_INPUT_JOYSTICK=y
CONFIG_INPUT_MISC=y
CONFIG_INPUT_KEYCHORD=y
CONFIG_INPUT_UINPUT=y
CONFIG_INPUT_GPIO=y
CONFIG_INV_AK8975=m
CONFIG_INV_MPU=m
CONFIG_INV_BMP180=m
# CONFIG_SERIO_I8042 is not set
CONFIG_SERIO_LIBPS2=y
# CONFIG_VT is not set
# CONFIG_LEGACY_PTYS is not set
# CONFIG_DEVKMEM is not set
CONFIG_SERIAL_8250=y
CONFIG_SERIAL_8250_CONSOLE=y
CONFIG_SERIAL_TEGRA=y
# CONFIG_HW_RANDOM is not set
CONFIG_I2C=y
# CONFIG_I2C_COMPAT is not set
CONFIG_I2C_CHARDEV=y
CONFIG_I2C_MUX=y
CONFIG_I2C_MUX_PCA954x=y
# CONFIG_I2C_HELPER_AUTO is not set
CONFIG_I2C_TEGRA=y
CONFIG_PINCTRL_PALMAS=y
CONFIG_PINCTRL_AS3722=y
CONFIG_DEBUG_GPIO=y
CONFIG_GPIO_SYSFS=y
CONFIG_GPIO_MAX77663=y
CONFIG_GPIO_PCA953X=y
CONFIG_GPIO_PCA953X_IRQ=y
CONFIG_GPIO_RC5T583=y
CONFIG_GPIO_PALMAS=y
CONFIG_GPIO_MAX77660=y
CONFIG_POWER_SUPPLY_EXTCON=y
CONFIG_CHARGER_BQ2419X=y
CONFIG_CHARGER_BQ2471X=y
CONFIG_CHARGER_BQ2477X=y
CONFIG_CHARGER_MAX77665=y
CONFIG_BATTERY_SBS=y
CONFIG_BATTERY_MAX17048=y
CONFIG_BATTERY_BQ27441=y
CONFIG_CHARGER_GPIO=y
CONFIG_CHARGER_EXTCON_MAX77660=y
CONFIG_BATTERY_CW201X=y
CONFIG_POWER_RESET_AS3722=y
CONFIG_POWER_OFF_PALMAS=y
CONFIG_SENSORS_INA219=y
CONFIG_SENSORS_INA230=y
CONFIG_SENSORS_INA3221=y
CONFIG_GENERIC_ADC_THERMAL=y
CONFIG_PWM_FAN=y
CONFIG_WATCHDOG=y
CONFIG_WATCHDOG_CORE=y
CONFIG_WATCHDOG_NOWAYOUT=y
CONFIG_MAX77660_SYSTEM_WATCHDOG=y
CONFIG_MFD_MAX77665=y
CONFIG_GPADC_TPS80031=y
CONFIG_MFD_RC5T583=y
CONFIG_MFD_MAX8831=y
CONFIG_MFD_AS3722=y
CONFIG_MFD_PALMAS=y
CONFIG_MFD_MAX77663=y
CONFIG_MFD_TPS65090=y
CONFIG_MFD_TPS6586X=y
CONFIG_MFD_TPS65910=y
CONFIG_MFD_TPS80031=y
CONFIG_MFD_MAX77660=y
CONFIG_REGULATOR=y
CONFIG_REGULATOR_FIXED_VOLTAGE=y
CONFIG_REGULATOR_VIRTUAL_CONSUMER=y
CONFIG_REGULATOR_USERSPACE_CONSUMER=y
CONFIG_REGULATOR_GPIO=y
CONFIG_REGULATOR_AS3722=y
CONFIG_REGULATOR_MAX8973=y
CONFIG_REGULATOR_MAX77663=y
CONFIG_REGULATOR_PWM=y
CONFIG_REGULATOR_RC5T583=y
CONFIG_REGULATOR_PALMAS=y
CONFIG_REGULATOR_TPS51632=y
CONFIG_REGULATOR_TPS62360=y
CONFIG_REGULATOR_TPS65090=y
CONFIG_REGULATOR_TPS6586X=y
CONFIG_REGULATOR_TPS65910=y
CONFIG_REGULATOR_TPS80031=y
CONFIG_REGULATOR_TPS6238X0=y
CONFIG_REGULATOR_MAX77660=y
# CONFIG_VGA_ARB is not set
CONFIG_VIDEO_OUTPUT_CONTROL=y
CONFIG_TEGRA_GRHOST_VI=y
# CONFIG_TEGRA_GRHOST_USE_NVMAP is not set
# CONFIG_TEGRA_GRHOST_USE_DMABUF is not set
CONFIG_TEGRA_DSI2EDP_SN65DSI86=y
# CONFIG_TEGRA_CAMERA is not set
CONFIG_BACKLIGHT_LCD_SUPPORT=y
CONFIG_LCD_CLASS_DEVICE=y
# CONFIG_BACKLIGHT_GENERIC is not set
CONFIG_BACKLIGHT_PWM=m
CONFIG_BACKLIGHT_MAX8831=m
# CONFIG_HID is not set
CONFIG_I2C_HID=y
# CONFIG_USB_SUPPORT is not set
CONFIG_MMC=y
CONFIG_MMC_UNSAFE_RESUME=y
CONFIG_MMC_BLOCK_MINORS=16
CONFIG_MMC_TEST=y
CONFIG_MMC_SDHCI=y
CONFIG_MMC_SDHCI_PLTFM=y
CONFIG_MMC_SDHCI_TEGRA=y
CONFIG_NEW_LEDS=y
CONFIG_LEDS_CLASS=y
CONFIG_LEDS_MAX8831=y
CONFIG_LEDS_GPIO=y
CONFIG_LEDS_TRIGGERS=y
CONFIG_LEDS_TRIGGER_TIMER=y
CONFIG_LEDS_TRIGGER_DEFAULT_ON=y
CONFIG_SWITCH=y
CONFIG_DMADEVICES=y
CONFIG_TEGRA20_APB_DMA=y
CONFIG_STAGING=y
CONFIG_MAX77660_ADC=y
CONFIG_AS3722_ADC_EXTCON=y
CONFIG_PALMAS_GPADC=y
CONFIG_SENSORS_CM3218=y
CONFIG_SENSORS_JSA1127=y
CONFIG_SENSORS_STM8T143=y
CONFIG_SENSORS_CM3217=y
CONFIG_ANDROID=y
CONFIG_ANDROID_BINDER_IPC=y
CONFIG_ASHMEM=y
CONFIG_ANDROID_LOGGER=y
CONFIG_ANDROID_TIMED_GPIO=y
CONFIG_ANDROID_LOW_MEMORY_KILLER=y
CONFIG_SYNC=y
CONFIG_PASR=y
CONFIG_CLK_PALMAS=y
CONFIG_CLK_AS3722=y
CONFIG_TEGRA_IOMMU_SMMU=y
CONFIG_EXTCON=y
CONFIG_EXTCON_PALMAS=y
CONFIG_IIO=y
CONFIG_PWM=y
CONFIG_PWM_TEGRA=y
CONFIG_EXT2_FS=y
CONFIG_EXT2_FS_XATTR=y
CONFIG_EXT2_FS_POSIX_ACL=y
CONFIG_EXT2_FS_SECURITY=y
CONFIG_EXT3_FS=y
# CONFIG_EXT3_DEFAULTS_TO_ORDERED is not set
CONFIG_EXT3_FS_POSIX_ACL=y
CONFIG_EXT3_FS_SECURITY=y
CONFIG_EXT4_FS=y
CONFIG_EXT4_FS_POSIX_ACL=y
CONFIG_EXT4_FS_SECURITY=y
# CONFIG_DNOTIFY is not set
CONFIG_FUSE_FS=y
CONFIG_VFAT_FS=y
CONFIG_NTFS_FS=y
CONFIG_TMPFS=y
CONFIG_CONFIGFS_FS=y
CONFIG_NLS_CODEPAGE_437=y
CONFIG_NLS_ISO8859_1=y
CONFIG_PRINTK_TIME=y
CONFIG_MAGIC_SYSRQ=y
CONFIG_DEBUG_FS=y
CONFIG_DEBUG_SECTION_MISMATCH=y
CONFIG_LOCKUP_DETECTOR=y
# CONFIG_DETECT_HUNG_TASK is not set
CONFIG_SCHEDSTATS=y
CONFIG_TIMER_STATS=y
# CONFIG_DEBUG_PREEMPT is not set
CONFIG_DEBUG_INFO=y
CONFIG_DEBUG_VM=y
CONFIG_FAULT_INJECTION=y
CONFIG_FAILSLAB=y
CONFIG_SECURITY=y
CONFIG_SECURITY_NETWORK=y
CONFIG_CRYPTO_AUTHENC=y
CONFIG_CRYPTO_CBC=y
CONFIG_CRYPTO_ECB=y
CONFIG_CRYPTO_HMAC=y
CONFIG_CRYPTO_MD5=y
CONFIG_CRYPTO_SHA1=y
CONFIG_CRYPTO_SHA256=y
CONFIG_CRYPTO_AES=y
CONFIG_CRYPTO_ARC4=y
CONFIG_CRYPTO_DES=y
CONFIG_CRYPTO_TWOFISH=y
CONFIG_CRYPTO_DEFLATE=y
# CONFIG_CRYPTO_ANSI_CPRNG is not set
CONFIG_CRC_CCITT=y
CONFIG_LIBCRC32C=y
CONFIG_AVERAGE=y
```

## arch/arm64/configs/tegra_t210ref_gnu_linux_defconfig
```kconfig
# CONFIG_SWAP is not set
CONFIG_NO_HZ=y
CONFIG_HIGH_RES_TIMERS=y
CONFIG_IKCONFIG=y
CONFIG_IKCONFIG_PROC=y
CONFIG_CGROUPS=y
CONFIG_CGROUP_DEBUG=y
CONFIG_CGROUP_FREEZER=y
CONFIG_CGROUP_CPUACCT=y
CONFIG_RESOURCE_COUNTERS=y
CONFIG_CGROUP_SCHED=y
CONFIG_RT_GROUP_SCHED=y
CONFIG_PANIC_TIMEOUT=10
# CONFIG_ELF_CORE is not set
CONFIG_EMBEDDED=y
CONFIG_SLAB=y
CONFIG_GCOV_TOOLCHAIN_IS_ANDROID=y
CONFIG_MODULES=y
CONFIG_MODULE_UNLOAD=y
CONFIG_MODULE_FORCE_UNLOAD=y
# CONFIG_BLK_DEV_BSG is not set
CONFIG_PARTITION_ADVANCED=y
# CONFIG_IOSCHED_DEADLINE is not set
# CONFIG_IOSCHED_CFQ is not set
CONFIG_ARCH_TEGRA=y
CONFIG_PM_DEVFREQ=y
CONFIG_TEGRA_CLOCK_DEBUG_WRITE=y
CONFIG_REGULATOR_TEGRA_DFLL_BYPASS=y
CONFIG_ARCH_TEGRA_21x_SOC=y
CONFIG_MACH_GRENADA=y
CONFIG_PCI_TEGRA=y
CONFIG_PCIEPORTBUS=y
CONFIG_PCIEASPM_POWERSAVE=y
CONFIG_SMP=y
CONFIG_PREEMPT=y
CONFIG_COMPAT=y
CONFIG_PM_RUNTIME=y
CONFIG_ARM64_CPU_SUSPEND=y
CONFIG_CPU_FREQ=y
CONFIG_CPU_FREQ_DEFAULT_GOV_USERSPACE=y
CONFIG_CPU_FREQ_GOV_POWERSAVE=y
CONFIG_CPU_FREQ_GOV_ONDEMAND=y
CONFIG_CPU_FREQ_GOV_INTERACTIVE=y
CONFIG_CPU_FREQ_GOV_CONSERVATIVE=y
CONFIG_CPU_IDLE=y
CONFIG_CPU_IDLE_MULTIPLE_DRIVERS=y
CONFIG_CPUQUIET_FRAMEWORK=y
CONFIG_NET=y
CONFIG_PACKET=y
CONFIG_UNIX=y
CONFIG_NET_KEY=y
CONFIG_INET=y
CONFIG_IP_MULTICAST=y
CONFIG_IP_PNP=y
CONFIG_IP_PNP_DHCP=y
CONFIG_IP_PNP_BOOTP=y
CONFIG_IP_PNP_RARP=y
CONFIG_NET_IPIP=y
CONFIG_IP_MROUTE=y
CONFIG_INET_ESP=y
# CONFIG_INET_XFRM_MODE_BEET is not set
# CONFIG_INET_LRO is not set
# CONFIG_IPV6 is not set
# CONFIG_NET_ACTIVITY_STATS is not set
CONFIG_DNS_RESOLVER=y
# CONFIG_WIRELESS is not set
CONFIG_DEVTMPFS=y
CONFIG_DEVTMPFS_MOUNT=y
# CONFIG_FIRMWARE_IN_KERNEL is not set
CONFIG_PLATFORM_ENABLE_IOMMU=y
CONFIG_MTD=y
CONFIG_MTD_QSPI_FLASH=y
CONFIG_PROC_DEVICETREE=y
CONFIG_BLK_DEV_LOOP=y
CONFIG_BLK_DEV_CRYPTOLOOP=y
CONFIG_SCSI=y
CONFIG_BLK_DEV_SD=y
CONFIG_BLK_DEV_SR=y
CONFIG_BLK_DEV_SR_VENDOR=y
CONFIG_SCSI_MULTI_LUN=y
CONFIG_NETDEVICES=y
CONFIG_DUMMY=y
CONFIG_SMC91X=y
CONFIG_SMSC911X=y
# CONFIG_WLAN is not set
# CONFIG_INPUT is not set
# CONFIG_SERIO is not set
# CONFIG_VT is not set
# CONFIG_LEGACY_PTYS is not set
CONFIG_SERIAL_8250=y
CONFIG_SERIAL_8250_CONSOLE=y
CONFIG_SERIAL_TEGRA=y
CONFIG_SERIAL_OF_PLATFORM=y
# CONFIG_HW_RANDOM is not set
CONFIG_I2C=y
CONFIG_I2C_CHARDEV=y
CONFIG_I2C_TEGRA=y
CONFIG_SPI=y
CONFIG_SPI_TEGRA114=y
CONFIG_SPI_TEGRA114_SLAVE=y
CONFIG_QSPI_TEGRA210=y
CONFIG_SPI_SPIDEV=y
CONFIG_PINCTRL_MAX77620=y
CONFIG_GPIO_SYSFS=y
CONFIG_GPIO_PCA953X=y
CONFIG_GPIO_PCA953X_IRQ=y
CONFIG_GPIO_MAX77620=y
CONFIG_POWER_OFF_MAX77620=y
# CONFIG_HWMON is not set
CONFIG_THERMAL_GOV_PID=y
CONFIG_MFD_MAX77620=y
CONFIG_REGULATOR=y
CONFIG_REGULATOR_FIXED_VOLTAGE=y
CONFIG_REGULATOR_GPIO=y
CONFIG_REGULATOR_MAX8973=y
CONFIG_REGULATOR_MAX77620=y
CONFIG_VIDEO_OUTPUT_CONTROL=y
CONFIG_FB=y
CONFIG_FB_MODE_HELPERS=y
CONFIG_TEGRA_GRHOST=y
# CONFIG_TEGRA_CAMERA is not set
CONFIG_BACKLIGHT_LCD_SUPPORT=y
CONFIG_BACKLIGHT_CLASS_DEVICE=y
CONFIG_SOUND=y
CONFIG_SND=y
# CONFIG_SND_SUPPORT_OLD_API is not set
# CONFIG_SND_VERBOSE_PROCFS is not set
# CONFIG_SND_DRIVERS is not set
CONFIG_SND_SOC=y
CONFIG_USB=y
CONFIG_USB_XHCI_HCD=m
CONFIG_TEGRA_XUSB_PLATFORM=y
CONFIG_USB_PHY=y
CONFIG_USB_GADGET=y
CONFIG_USB_TEGRA=y
CONFIG_MMC=y
CONFIG_MMC_UNSAFE_RESUME=y
CONFIG_MMC_EMBEDDED_SDIO=y
CONFIG_MMC_BLOCK_MINORS=16
CONFIG_MMC_BLOCK_DEFERRED_RESUME=y
CONFIG_MMC_SDHCI=y
CONFIG_MMC_SDHCI_PLTFM=y
CONFIG_MMC_SDHCI_TEGRA=y
CONFIG_SWITCH=y
CONFIG_RTC_CLASS=y
CONFIG_RTC_DRV_MAX77620=y
CONFIG_DMADEVICES=y
CONFIG_TEGRA20_APB_DMA=y
CONFIG_STAGING=y
CONFIG_ANDROID=y
CONFIG_ANDROID_BINDER_IPC=y
CONFIG_ASHMEM=y
CONFIG_ANDROID_LOGGER=y
CONFIG_ANDROID_LOW_MEMORY_KILLER=y
CONFIG_TEGRA_IOMMU_SMMU=y
CONFIG_EXT2_FS=y
CONFIG_EXT2_FS_XATTR=y
CONFIG_EXT2_FS_POSIX_ACL=y
CONFIG_EXT2_FS_SECURITY=y
CONFIG_EXT3_FS=y
# CONFIG_EXT3_DEFAULTS_TO_ORDERED is not set
CONFIG_EXT3_FS_POSIX_ACL=y
CONFIG_EXT3_FS_SECURITY=y
CONFIG_EXT4_FS=y
# CONFIG_DNOTIFY is not set
CONFIG_FUSE_FS=y
CONFIG_VFAT_FS=y
CONFIG_TMPFS=y
CONFIG_NFS_FS=y
CONFIG_ROOT_NFS=y
CONFIG_CIFS=y
CONFIG_NLS_CODEPAGE_437=y
CONFIG_NLS_ISO8859_1=y
CONFIG_PRINTK_TIME=y
CONFIG_MAGIC_SYSRQ=y
CONFIG_READABLE_ASM=y
CONFIG_LESS_GCC_OPT=y
CONFIG_SCHEDSTATS=y
CONFIG_TIMER_STATS=y
CONFIG_DEBUG_INFO=y
CONFIG_IRQSOFF_TRACER=y
CONFIG_KEYS=y
CONFIG_CRYPTO_TWOFISH=y
CONFIG_CRYPTO_DEFLATE=y
# CONFIG_CRYPTO_ANSI_CPRNG is not set
CONFIG_CRYPTO_DEV_TEGRA_SE=y
CONFIG_CRC_CCITT=y
CONFIG_LIBCRC32C=y
```

## arch/arm64/mach-tegra/Kconfig
```kconfig
source drivers/devfreq/Kconfig

source arch/arm/mach-tegra/Kconfig

config ARCH_TEGRA_13x_SOC
	bool "Tegra 13x family SOC"
	depends on !ARCH_TEGRA_14x_SOC
	select ARCH_TEGRA_HAS_PCIE
	select CPU_V8
	select DENVER_CPU
	select ARM_GIC
	select ARCH_REQUIRE_GPIOLIB
	select USB_ARCH_HAS_EHCI if USB_SUPPORT
	select USB_EHCI_TEGRA if USB_SUPPORT
	select USB_ULPI if USB_SUPPORT
	select USB_ULPI_VIEWPORT if USB_SUPPORT
	select REPORT_PRESENT_CPUS if TEGRA_AUTO_HOTPLUG
	select ARCH_SUPPORTS_MSI if TEGRA_PCI
	select PCI_MSI if TEGRA_PCI
	select ARCH_TEGRA_HAS_CL_DVFS
	select TEGRA_DYNAMIC_CBUS
	select TEGRA_DUAL_CBUS
	select ARCH_TEGRA_VIC
	select SOC_BUS
	select THERMAL
	select PM_GENERIC_DOMAINS if PM
	select MACH_HAS_SND_SOC_TEGRA_MAX98090 if SND_SOC
	select MACH_HAS_SND_SOC_TEGRA_RT5639 if SND_SOC
	help
	  Support for NVIDIA Tegra 13x family of SoCs, based upon the
	  NVIDIA Denver CPU

config MACH_EXUMA
	bool "Exuma board"
	depends on ARCH_TEGRA_13x_SOC
	select TEGRA_FPGA_PLATFORM
	help
	  Support for NVIDIA Exuma FPGA development platform

config MACH_T132REF
	bool "T132REF board"
	depends on ARCH_TEGRA_13x_SOC
	select SYSEDP_FRAMEWORK
	help
	  Support for NVIDIA Exuma FPGA development platform

config DENVER_CPU
	bool "Denver CPU"
	help
	  Support for NVIDIA Denver CPU
```

## drivers/cpuidle/Kconfig
```kconfig
menuconfig CPU_IDLE
	bool "CPU idle PM support"
	default y if ACPI || PPC_PSERIES
	select CPU_IDLE_GOV_LADDER if (!NO_HZ && !NO_HZ_IDLE)
	select CPU_IDLE_GOV_MENU if (NO_HZ || NO_HZ_IDLE)
	help
	  CPU idle is a generic framework for supporting software-controlled
	  idle processor power management.  It includes modular cross-platform
	  governors that can be swapped during runtime.

	  If you're using an ACPI-enabled platform, you should say Y here.

if CPU_IDLE

config CPU_IDLE_MULTIPLE_DRIVERS
        bool "Support multiple cpuidle drivers"
        default n
        help
         Allows the cpuidle framework to use different drivers for each CPU.
         This is useful if you have a system with different CPU latencies and
         states. If unsure say N.

config CPU_IDLE_GOV_LADDER
	bool "Ladder governor (for periodic timer tick)"
	default y

config CPU_IDLE_GOV_MENU
	bool "Menu governor (for tickless system)"
	default y

config CPU_IDLE_CALXEDA
	bool "CPU Idle Driver for Calxeda processors"
	depends on ARCH_HIGHBANK
	help
	  Select this to enable cpuidle on Calxeda processors.

config CPU_IDLE_DENVER
	bool "CPU Idle Driver for NVIDIA Denver processors"
	depends on DENVER_CPU
	default y
	help
	  Select this to enable cpuidle on NVIDIA Denver processors.

config CPU_IDLE_TEGRA210
	bool "CPU Idle Driver for NVIDIA Tegra210 SoC"
	depends on ARCH_TEGRA_21x_SOC
	default y
	help
          Support for entering different power states on NVIDIA Tegra210
          SoC when CPUs become idle.

          Select this to enable cpuidle on NVIDIA Tegra210 SoC.

endif

config ARCH_NEEDS_CPU_IDLE_COUPLED
	def_bool n
```
