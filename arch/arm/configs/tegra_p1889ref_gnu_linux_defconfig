## drivers/platform/tegra/nvadsp/Kconfig
```kconfig
config TEGRA_NVADSP
	bool "Enable Host ADSP driver"
	depends on ARCH_TEGRA_APE
	default n
	help
	  Enables support for Host ADSP driver.

	  If unsure, say N

config TEGRA_APE_AGIC
	bool "Enable AGIC interrupt controller"
	depends on ARCH_TEGRA_APE
	default n
	help
	  The AGIC interrupt controller is based on GIC 400. Use this
	  controller if the tegra platform needs interrupts from/to
	  APE modules.

	  If unsure, say N

config TEGRA_NVADSP_ON_SMMU
	bool "Use SMMU to relocate ADSP"
	depends on TEGRA_IOMMU_SMMU && TEGRA_NVADSP
	default y
	help
	  Use SMMU to relocate ADSP OS.

config TEGRA_ADSP_DFS
	bool "Enable ADSP DFS"
	depends on ARCH_TEGRA_APE
	default y
	help
	  Enable ADSP dynamic frequency scaling.

	  If unsure, say N

config TEGRA_EMC_APE_DFS
	bool "Enable emc dfs due to APE"
	depends on ARCH_TEGRA_APE
	default y
	help
	  Enable emc dfs due to APE DRAM access

	  If unsure, say N
```

## drivers/staging/iio/light/Kconfig
```kconfig
#
# Light sensors
#
menu "Light sensors"

config SENSORS_ISL29018
	tristate "ISL 29018 light and proximity sensor"
	depends on I2C
	select REGMAP_I2C
	default n
	help
	 If you say yes here you get support for ambient light sensing and
	 proximity infrared sensing from Intersil ISL29018.
	 This driver will provide the measurements of ambient light intensity
	 in lux, proximity infrared sensing and normal infrared sensing.
	 Data from sensor is accessible via sysfs.

config SENSORS_ISL29028
	tristate "Intersil ISL29028/ISL29028 Concurrent Light and Proximity Sensor"
	depends on I2C
	select REGMAP_I2C
	help
	 Provides driver for the Intersil's ISL29028/ISL29029 device.
	 This driver supports the sysfs interface to get the ALS, IR intensity,
	 Proximity value via iio. The ISL29028 provides the concurrent sensing
	 of ambient light and proximity.

config TSL2583
	tristate "TAOS TSL2580, TSL2581 and TSL2583 light-to-digital converters"
	depends on I2C
	help
	 Provides support for the TAOS tsl2580, tsl2581 and tsl2583 devices.
	 Access ALS data via iio, sysfs.

config TSL2x7x
	tristate "TAOS TSL/TMD2x71 and TSL/TMD2x72 Family of light and proximity sensors"
	depends on I2C
	help
	 Support for: tsl2571, tsl2671, tmd2671, tsl2771, tmd2771, tsl2572, tsl2672,
	 tmd2672, tsl2772, tmd2772 devices.
	 Provides iio_events and direct access via sysfs.

config SENSORS_LTR558
	tristate "LTR558 Ambient light and proximity sensor"
	depends on I2C
	default n
	help
	  If you say yes here you get support for ambient light sensing and
	  proximity ir sensing from Lite On Technology LTR558.

config SENSORS_MAX44005
	tristate "MAX44005 ALS, RGB, temperature, IR, proximity Sensor"
	depends on I2C
	default n
	help
	  If you say yes here you get support for ambient light, RGB, IR,
	  Proximity and temperature sensing from MAX44005.

config SENSORS_CM3218
	tristate "CM3218 Ambient light sensor"
	depends on I2C
	help
	  Say Y here to enable the CM3218 Ambient Light Sensor.

endmenu
```

## drivers/staging/nvshm/Kconfig
```kconfig
config NVSHM
	tristate "NV Tegra Baseband Shared Memory Interface"
	depends on ARCH_TEGRA
	depends on TEGRA_BASEBAND
	depends on SUNRPC
	help
	    Say Y here to enable support for high level shared memory interface
	    driver on NVIDIA Tegra integrated baseband
```
