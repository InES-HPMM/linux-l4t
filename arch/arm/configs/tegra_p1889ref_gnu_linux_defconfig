## drivers/iio/light/Kconfig
```kconfig
#
# Light sensors
#
menu "Light sensors"

config ADJD_S311
	tristate "ADJD-S311-CR999 digital color sensor"
	select IIO_BUFFER
	select IIO_TRIGGERED_BUFFER
	depends on I2C
	help
	 If you say yes here you get support for the Avago ADJD-S311-CR999
	 digital color light sensor.

	 This driver can also be built as a module.  If so, the module
	 will be called adjd_s311.

config SENSORS_LM3533
	tristate "LM3533 ambient light sensor"
	depends on MFD_LM3533
	help
	  If you say yes here you get support for the ambient light sensor
	  interface on National Semiconductor / TI LM3533 Lighting Power
	  chips.

	  The sensor interface can be used to control the LEDs and backlights
	  of the chip through defining five light zones and three sets of
	  corresponding output-current values.

	  The driver provides raw and mean adc readings along with the current
	  light zone through sysfs. A threshold event can be generated on zone
	  changes. The ALS-control output values can be set per zone for the
	  three current output channels.

config SENSORS_TSL2563
	tristate "TAOS TSL2560, TSL2561, TSL2562 and TSL2563 ambient light sensors"
	depends on I2C
	help
	 If you say yes here you get support for the Taos TSL2560,
	 TSL2561, TSL2562 and TSL2563 ambient light sensors.

	 This driver can also be built as a module.  If so, the module
	 will be called tsl2563.

config VCNL4000
	tristate "VCNL4000 combined ALS and proximity sensor"
	depends on I2C
	help
	 Say Y here if you want to build a driver for the Vishay VCNL4000
	 combined ambient light and proximity sensor.

	 To compile this driver as a module, choose M here: the
	 module will be called vcnl4000.

config HID_SENSOR_ALS
	depends on HID_SENSOR_HUB
	select IIO_BUFFER
	select IIO_TRIGGERED_BUFFER
	select HID_SENSOR_IIO_COMMON
	select HID_SENSOR_IIO_TRIGGER
	tristate "HID ALS"
	help
	  Say yes here to build support for the HID SENSOR
	  Ambient light sensor.

config NVS_BH1730FVC
	tristate "ROHM BH1730FVC ALS"
	select NVS_IIO
	select NVS_LIGHT
	select IIO_BUFFER
	select IIO_TRIGGERED_BUFFER
	depends on I2C
	help
	  Say Y here for ROHM Co., Ltd. BH1730FVC
	  Digital 16bit Serial Output Type
	  Ambient Light Sensor (ALS) support.

	  The driver uses the NVS (NVidia Sensor) IIO, light framework.

config NVS_CM3217
	tristate "Capella CM3217 ALS"
	select NVS_IIO
	select NVS_LIGHT
	select IIO_BUFFER
	select IIO_TRIGGERED_BUFFER
	depends on I2C
	help
	  Say Y here for Capella Microsystems, Inc. CM3217
	  Ambient Light Sensor (ALS) support.

	  The driver uses the NVS (NVidia Sensor) IIO, light framework.

config NVS_CM3218
	tristate "Capella CM3218 ALS"
	select NVS_IIO
	select NVS_LIGHT
	select IIO_BUFFER
	select IIO_TRIGGERED_BUFFER
	depends on I2C
	help
	  Say Y here for Capella Microsystems, Inc. CM3218 and CM32181
	  Ambient Light Sensor (ALS) driver support.

	  The driver uses the NVS (NVidia Sensor) IIO, light framework.

config NVS_ISL2902X
	tristate "INTERSIL ISL2902X ALS/Proximity"
	select NVS_IIO
	select NVS_LIGHT
	select NVS_PROXIMITY
	select IIO_BUFFER
	select IIO_TRIGGERED_BUFFER
	depends on I2C
	help
	  Say Y here for Intersil ISL29028 and ISL29029
	  Ambient Light Sensor (ALS) and proximity driver
	  support.

	  The driver uses the NVS (NVidia Sensor) IIO, light and
	  proximity framework.

config NVS_JSA1127
	tristate "SOLTEAMOPTO JSA1127 ALS"
	select NVS_IIO
	select NVS_LIGHT
	select IIO_BUFFER
	select IIO_TRIGGERED_BUFFER
	depends on I2C
	help
	  Say Y here for Solteamopto JSA1127
	  Ambient Light Sensor (ALS) driver support.

	  The driver uses the NVS (NVidia Sensor) IIO, light framework.

config NVS_LTR659
	tristate "LITEON LTR-659PS or LTR_558ALS"
	select NVS_IIO
	select NVS_LIGHT
	select NVS_PROXIMITY
	select IIO_BUFFER
	select IIO_TRIGGERED_BUFFER
	depends on I2C
	help
	  Say Y here for LITEON LTR-659PS or LTR-558ALS
	  ALS/proximity sensor driver support.

	  The driver uses the NVS (NVidia Sensor) IIO, light and
	  proximity framework.

config NVS_MAX4400X
	tristate "Maxim MAX4400X ALS/Proximity"
	select NVS_IIO
	select NVS_LIGHT
	select NVS_PROXIMITY
	select IIO_BUFFER
	select IIO_TRIGGERED_BUFFER
	depends on I2C
	help
	  Say Y here for Maxim MAX44005 and MAX44006/MAX44008
	  Ambient Light Sensor (ALS) support.
	  Proximity is supported on the MAX44005.

	  The driver uses the NVS (NVidia Sensor) IIO, light and
	  proximity framework.

endmenu
```

## drivers/iio/pressure/Kconfig
```kconfig
#
# Pressure sensors
#
menu "Pressure sensors"

config NVI_BMPX80
	tristate "Bosch Digital pressure sensor"
	depends on I2C
	select IIO_BUFFER
	select IIO_TRIGGERED_BUFFER
	select NVS_IIO
	help
	  Say yes here to build support for Bosch pressure sensor
	  that can be connected via Invensense MPU.

	  To compile this driver as a module, choose M here: the module
	  will be called nvi-bmpX80.

endmenu
```

## drivers/iio/proximity/Kconfig
```kconfig
#
# proximity sensors
#
menu "Proximity sensors"

config NVS_IQS2X3
	tristate "Azoteq IQS253/IQS263 SAR proximity"
	select NVS_IIO
	select NVS_PROXIMITY
	select IIO_BUFFER
	select IIO_TRIGGERED_BUFFER
	depends on I2C
	help
	  Say Y here for Azoteq IQS253 and IQS263 SAR proximity support.

	  The driver uses the NVS (NVidia Sensor) IIO and proximity
	  framework.

endmenu
```

## drivers/media/platform/tegra/nvavp-virt/Kconfig
```kconfig
config TEGRA_NVAVP_VIRT
	bool "Enable support for Tegra NVAVP virtual driver"
	depends on ARCH_TEGRA && TEGRA_GRHOST && !TEGRA_NVAVP_AUDIO
	default n
	help
	  Enables support for the push-buffer mechanism based driver for the Tegra
	  multimedia framework. Exports the Tegra nvavp interface on device node
	  /dev/tegra_avpchannel.

	  If unsure, say N

config TEGRA_NVAVP_ENCRYPTED_STREAMS
        bool "Enable support for decoding AES excrypted streams in AVP"
        depends on TEGRA_NVAVP_VIRT
        default n
        help
          Enables support for decoding DRM encrypted video streams in AVP.

          If unsure, say N
```

## drivers/mipi_bif/Kconfig
```kconfig
menuconfig MIPI_BIF
	tristate "MIPI_BIF support"
	depends on HAS_IOMEM
	select RT_MUTEXES
	---help---
	 Say y here if you want MIPI_BIF support to be
	 enabled.
```

## drivers/net/wireless/bcmdhd2/Kconfig
```kconfig
config BCMDHD2
	tristate "Broadcom FullMAC wireless cards support"
	---help---
	  This module adds support for wireless adapters based on
	  Broadcom FullMAC chipset.

	  If you choose to build a module, it'll be called dhd. Say M if
	  unsure.

config BCMDHD2_SDIO
	bool "SDIO bus interface support"
	depends on BCMDHD2 && MMC
	default y

config BCMDHD2_PCIE
	bool "PCIe bus interface support"
	depends on BCMDHD2 && PCI && !BCMDHD2_SDIO

config BCMDHD2_BCM4354
	bool "Broadcom 4354 wireless cards PRC support"
	depends on BCMDHD2
	---help---
	  This module adds support for wireless adapters based on
	  Broadcom 4354 chipset.

config BCMDHD2_BCM4339
	bool "Broadcom 4339 wireless cards PRC support"
	depends on BCMDHD2
	---help---
	  This module adds support for wireless adapters based on
	  Broadcom 4339 chipset.

config BCMDHD2_FW_PATH
	depends on BCMDHD2
	string "Firmware path"
	default "/system/vendor/firmware/fw_bcmdhd.bin"
	---help---
	  Path to the firmware file.

config BCMDHD2_NVRAM_PATH
	depends on BCMDHD2
	string "NVRAM path"
	default "/system/etc/wifi/bcmdhd.cal"
	---help---
	  Path to the calibration file.

config BCMDHD2_HW_OOB
	bool "Use out of band interrupt"
	depends on BCMDHD2
	default y
	---help---
	  Use out of band interrupt for card interrupt and wake on wireless.

config BCMDHD2_WEXT
	bool "Enable WEXT support"
	depends on BCMDHD2 && CFG80211 = n
	select WIRELESS_EXT
	select WEXT_PRIV
	help
	  Enables WEXT support

config DHD2_USE_STATIC_BUF
	bool "Enable memory preallocation"
	depends on BCMDHD2
	default n
	---help---
	  Use memory preallocated in platform

config DHD2_USE_SCHED_SCAN
	bool "Use CFG80211 sched scan"
	depends on BCMDHD2 && CFG80211
	default n
	---help---
	  Use CFG80211 sched scan
```

## drivers/net/wireless/bcmdhd_88/Kconfig
```kconfig
config BCMDHD88
	tristate "Broadcom 43xx wireless cards support"
	depends on MMC && CFG80211
	---help---
	  This module adds support for wireless adapters based on
	  Broadcom 43xx chipset.

	  This driver uses the kernel's cfg80211 subsystem.

	  If you choose to build a module, it'll be called dhd. Say M if
	  unsure.

config BCM43341
	bool "Broadcom 43341/43340 wireless card support"
	depends on BCMDHD88

config BCM4335
	bool "Broadcom 4335 wireless card support"
	depends on BCMDHD88

config BCM4339
	bool "Broadcom 4339 wireless card support"
	depends on BCMDHD88

config BCM4350
	bool "Broadcom 4350 wireless card support"
	depends on BCMDHD88

config BCMDHD88_FW_PATH
	depends on BCMDHD88
	string "Firmware path"
	default "/system/etc/firmware/fw_bcmdhd.bin"
	---help---
	  Path to the firmware file.

config BCMDHD88_NVRAM_PATH
	depends on BCMDHD88
	string "NVRAM path"
	default "/system/etc/wifi/bcmdhd.cal"
	---help---
	  Path to the calibration file.

config BCMDHD88_HW_OOB
	bool "Use out of band interrupt"
	depends on BCMDHD88
	default n
	---help---
	  Use out of band interrupt for card interrupt and wake on wireless.

config BCMDHD88_INSMOD_NO_FW_LOAD
	bool "Enable delayed firmware load"
	depends on BCMDHD88
	default n
	---help---
	Enable delayes firmware

config DHD_USE_STATIC_BUF
	bool "Enable memory preallocation"
	depends on BCMDHD88
	default n
	---help---
	  Use memory preallocated in platform

config DHD_USE_SCHED_SCAN
	bool "Use CFG80211 sched scan"
	depends on BCMDHD88 && CFG80211
	default n
	---help---
	  Use CFG80211 sched scan

config BCMDHD88_DISABLE_P2P_SYSFS_DEVICE_NODE
	bool "Disable sysfs entry for P2P interfaces"
	depends on BCMDHD88
	default n
	---help---
	Disable creation of sysfs device node for P2P interfaces.
	This is a workaround to prevent management tools from
	directly managing P2P virtual devices.

config BCMDHD_CUSTOM_SYSFS_TEGRA
	bool "Custom sysfs for Tegra platform"
	depends on BCMDHD88
	default y
	---help---
	  Enable custom sysfs for Tegra platform.

config BCMDHD88_TEGRA_REGION_BASED_NVRAM
	bool "Region based nvram/country code selection for Tegra platform"
	depends on BCMDHD88
	---help---
	  Enable dynamic region based selection of nvram parameters.
```

## drivers/pci/host/Kconfig
```kconfig
#
# PCIE Host Controller Drivers
#
comment "PCIE Host Controller Drivers"

config PCI_TEGRA
    tristate "NVIDIA Tegra PCIe controller"
    default n
    depends on PLATFORM_TEGRA
    select PCI
    select TEGRA_USB_SHARED_PAD
    select ARCH_TEGRA_HAS_PCIE
    help
      Say Y here if you want support for the PCIe host controller found
      on NVIDIA Tegra SoCs.

config ARCH_TEGRA_HAS_PCIE
	bool
```

## drivers/platform/Kconfig
```kconfig
if X86
source "drivers/platform/x86/Kconfig"
endif
if GOLDFISH
source "drivers/platform/goldfish/Kconfig"
endif
if ARCH_TEGRA
source "drivers/platform/tegra/Kconfig"
endif
```

## drivers/platform/tegra/Kconfig
```kconfig
# Copyright (c) 2012-2014, NVIDIA CORPORATION.  All rights reserved.
#
# This program is free software; you can redistribute it and/or modify it
# under the terms and conditions of the GNU General Public License,
# version 2, as published by the Free Software Foundation.
#
# This program is distributed in the hope it will be useful, but WITHOUT
# ANY WARRANTY; without even the implied warranty of MERCHANTABILITY or
# FITNESS FOR A PARTICULAR PURPOSE.  See the GNU General Public License for
# more details.
#
# You should have received a copy of the GNU General Public License
# along with this program.  If not, see <http://www.gnu.org/licenses/>.

comment "NVIDIA Tegra options"

config TEGRA_CLK_FRAMEWORK
	bool "Tegra clock framework"
	default y
	help
	  Enable Tegra clock framework.

config TEGRA_MC
	bool "Tegra MC"
	default y
	help
	  Enable Tegra MC.

config TEGRA_MC_DOMAINS
	bool "Enable Tegra MC PM domain"
	depends on TEGRA_MC
	depends on PM_GENERIC_DOMAINS
	default n
	help
	  When enabled, clock gates MC when it's not needed.

config TEGRA_WAKEUP_MONITOR
	bool "Enable tegra wakeup monitor"
	depends on PM_SLEEP && ANDROID_INTF_ALARM_DEV
	help
	  This option enables support for the monitor of tegra wakeups, it will
	  send out wakeup source and uevents which indicate suspend_prepare and
	  post_suspend.

config TEGRA_COMMON
	bool "Tegra common support"
	default y
	help
	  Enable Tegra common support.

config TEGRA_DEVICES
	bool "Tegra devices"
	default y
	help
	  Enable misc Tegra devices.

config TEGRA3_PM
	bool "Tegra3 power and cluster management"
	default y
	help
	  Enable Tegra3 power and cluster management.

config TEGRA_PMC
	bool "Tegra PMC"
	default y
	help
	  Enable Tegra PMC.

config TEGRA_POWERGATE
	bool "Tegra powergate support"
	default y
	help
	  Enable Tegra powergate support.

config TEGRA_CORE_VOLT_CAP
	bool "Tegra core voltage cap support."
	depends on TEGRA_CLK_FRAMEWORK
	default y
	help
	  Enable Tegra core voltage cap support.

config TEGRA_BOARD_COMMON
	bool "Tegra common board support"
	default y
	help
	  Enable Tegra common board support.

config TEGRA_BOOTLOADER_DEBUG
	tristate "Creates sys-fs interface dumping registers read by bootloader"
	default n
	help
	  When enabled, tegra_bootloader_verify_regs sys-fs is created.

config TEGRA_BPMP_SCLK_SKIP
	bool "Let bpmp firmware own the sclk skipper h/w"
	depends on TEGRA_BPMP && ARCH_TEGRA_21x_SOC
	default n
	help
	  When enabled, sclk skipper set rate will be delegated to bpmp firmware

config TEGRA_CBUS_CAN_USE_SKIPPERS
	bool "Allow to use clock skippers on cbus users"
	depends on ARCH_TEGRA_21x_SOC
	default n
	help
	  When enabled, clock skippers for cbus modules can be used to provide
	  fine granularity clock rate control

config TEGRA_CAMERA_MIPI_CAL
	bool "Tegra camera MIPI calibration"
	default y
	help
	  Enable Tegra camera MIPI calibration.

config TEGRA_KFUSE
	bool "Tegra kfuse support"
	default y
	help
	  Enable Tegra kfuse support. The kfuse block stores downstream and
	  upstream HDCP keys for use by the HDMI module.

config TEGRA_SOCTHERM
	bool "Enable soctherm"
	default y
        help
	  Enables use of soctherm for thermal management.

config TEGRA_EDP_LIMITS
	bool "Enforce electrical design limits on CPU rail"
	depends on CPU_FREQ
	depends on THERMAL
	default n
	select TEGRA_PROC_POWER_MODEL
	help
	  Limit maximum CPU frequency based on temperature and number
	  of on-line CPUs to keep CPU rail current within power supply
	  capabilities.

config TEGRA_GPU_EDP
       bool "GPU EDP management"
       depends on THERMAL
       select TEGRA_PROC_POWER_MODEL
       default n
       help
         Limit maximum GPU frequency based on temperature
         to keep GPU rail current within power supply
         capabilities.

config TEGRA_ACTMON
	bool "Tegra Activity Monitor"
	depends on ARCH_TEGRA_12x_SOC || ARCH_TEGRA_21x_SOC
	default y
	help
	  Actmon is a hardware block that can be used to track the activity of
	  certain hardware units. It can boost EMC clock or AVP clock depending
	  on the memory trafic among various client. If unsure, say Y here.
```
