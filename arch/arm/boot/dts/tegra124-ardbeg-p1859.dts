/*
 * arch/arm/boot/dts/tegra124-ardbeg-p1859.dts
 *
 * Copyright (c) 2013-2014, NVIDIA CORPORATION.  All rights reserved.
 *
 * This program is free software; you can redistribute it and/or modify
 * it under the terms of the GNU General Public License as published by
 * the Free Software Foundation; version 2 of the License.
 *
 * This program is distributed in the hope that it will be useful, but WITHOUT
 * ANY WARRANTY; without even the implied warranty of MERCHANTABILITY or
 * FITNESS FOR A PARTICULAR PURPOSE.  See the GNU General Public License for
 * more details.
 *
 * You should have received a copy of the GNU General Public License along
 * with this program; if not, write to the Free Software Foundation, Inc.,
 * 51 Franklin Street, Fifth Floor, Boston, MA  02110-1301, USA.
 *
 */

 /dts-v1/;

/* This file is for Vibrante 3.0 Android */
#include "tegra124-p1859.dtsi"

/ {
	gpio-keys {
		compatible = "gpio-keys";
		pwr_int_n {
			label = "Power";
			interrupts = <0 86 IRQ_TYPE_NONE>;
			linux,code = <KEY_POWER>;
			gpio-key,wakeup;
			debounce-interval = <100>;
		};
	};
};
