/*
 * arch/arm/boot/dts/tegra124-tn8-a03-00.dts
 *
 * Copyright (c) 2014-2014, NVIDIA CORPORATION.  All rights reserved.
 *
 * This program is free software; you can redistribute it and/or modify
 * it under the terms of the GNU General Public License as published by
 * the Free Software Foundation; either version 2 of the License, or
 * (at your option) any later version.
 *
 * This program is distributed in the hope that it will be useful, but WITHOUT
 * ANY WARRANTY; without even the implied warranty of MERCHANTABILITY or
 * FITNESS FOR A PARTICULAR PURPOSE.  See the GNU General Public License for
 * more details.
 *
 * You should have received a copy of the GNU General Public License along
 * with this program; if not, write to the Free Software Foundation, Inc.,
 * 51 Franklin Street, Fifth Floor, Boston, MA  02110-1301, USA.
 */
/dts-v1/;

#include "tegra124-tn8.dtsi"
#include "tegra124-platforms/tegra124-tn8-emc-p1761-1270-a00.dtsi"
#include "tegra124-platforms/tegra124-tn8-pmic-e1936-1000-a00.dtsi"
#include "tegra124-platforms/tegra124-tn8-sensor-p1761-1270-a03.dtsi"
#include "tegra124-platforms/tegra124-tn8-fixed-e1936-1000-a03.dtsi"
#include "tegra124-platforms/tegra124-tn8-sensor-p1761-1470-a00.dtsi"
#include "tegra124-platforms/tegra124-tn8-pinmux-p1761-1470-a00.dtsi"
#include "tegra124-platforms/tegra124-tn8-gpio-p1761-1470-a00.dtsi"
#include "tegra124-platforms/tegra124-tn8-keys-p1761-1270-a03.dtsi"
#include "tegra124-platforms/tegra124-tn8-sysedp-p1761-1270-a03.dtsi"
#include "tegra124-platforms/tegra124-tn8-powermon-p1761-a02.dtsi"
#include "tegra124-platforms/tegra124-tn8-dfll-p1761-1270-a03.dtsi"
#include "tegra124-platforms/tegra124-tn8-camera-p1761-1270-a03.dtsi"

/ {
	model = "NVIDIA Tegra124 TN8 FFD";
	compatible = "nvidia,tn8", "nvidia,tegra124";
	nvidia,dtsfilename = __FILE__;
	nvidia,boardids = "1761:1270:3";
	#address-cells = <2>;
	#size-cells = <2>;

	chosen {
		bootargs = "tegraid=40.0.0.00.00 vmalloc=256M video=tegrafb console=ttyS0,115200n8 earlyprintk";
		linux,initrd-start = <0x85000000>;
		linux,initrd-end = <0x851bc400>;
	};

};

