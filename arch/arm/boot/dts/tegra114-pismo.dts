/dts-v1/;

/include/ "tegra114.dtsi"
#include <tegra114-platforms/tegra114-pismo-gpio-default.dtsi>
#include <tegra114-platforms/tegra114-pismo-pinmux.dtsi>

/ {
	model = "NVIDIA Tegra114 Pismo evaluation board";
	compatible = "nvidia,pismo", "nvidia,tegra114";

	i2c@7000d000 {
		nvidia,bit-banging-xfer-after-shutdown;
	};
};
