/dts-v1/;

/include/ "tegra114.dtsi"

/ {
	model = "NVIDIA Tegra114 curacao evaluation board";
	compatible = "nvidia,curacao", "nvidia,tegra114";

	clocks {
		compatible = "simple-bus";
		#address-cells = <1>;
		#size-cells = <0>;

		clk32k_in: clock {
			compatible = "fixed-clock";
			reg=<0>;
			#clock-cells = <0>;
			clock-frequency = <32768>;
		};
	};
};
