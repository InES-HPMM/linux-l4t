#include <dt-bindings/gpio/tegra-gpio.h>

/ {
	gpio: gpio@6000d000 {
		gpio-init-names = "default";
		gpio-init-0 = <&gpio_default>;

		gpio_default: default {
			gpio-input = <  TEGRA_GPIO(W, 2)
					TEGRA_GPIO(V, 0)
					TEGRA_GPIO(V, 1)
					TEGRA_GPIO(K, 0)
					TEGRA_GPIO(K, 1)
					TEGRA_GPIO(J, 2)
					TEGRA_GPIO(K, 4)
					TEGRA_GPIO(K, 2)
					TEGRA_GPIO(I, 3)
					TEGRA_GPIO(I, 6)
					TEGRA_GPIO(I, 2)
					TEGRA_GPIO(I, 5)
					TEGRA_GPIO(DD, 3)
					TEGRA_GPIO(FF, 2)
					TEGRA_GPIO(Q, 0)
					TEGRA_GPIO(Q, 1)
					TEGRA_GPIO(Q, 2)
					TEGRA_GPIO(Q, 3)
					TEGRA_GPIO(Q, 6)
					TEGRA_GPIO(Q, 7)
					TEGRA_GPIO(S, 3)
					TEGRA_GPIO(S, 4)
					TEGRA_GPIO(S, 5)
					TEGRA_GPIO(R, 2)
					TEGRA_GPIO(R, 4)
					TEGRA_GPIO(EE, 1)
					TEGRA_GPIO(N, 7)>;
			gpio-output-low = <TEGRA_GPIO(K, 3)
					TEGRA_GPIO(W, 5)
					TEGRA_GPIO(R, 3)
					TEGRA_GPIO(R, 5)
					TEGRA_GPIO(R, 6)>;
			gpio-output-high = <TEGRA_GPIO(R, 0)>;
		};
	};
};
