/*
 * Copyright (c) 2014, NVIDIA CORPORATION.  All rights reserved.
 *
 * This program is free software; you can redistribute it and/or modify
 * it under the terms of the GNU General Public License as published by
 * the Free Software Foundation; version 2 of the License.
 *
 * This program is distributed in the hope that it will be useful, but WITHOUT
 * ANY WARRANTY; without even the implied warranty of MERCHANTABILITY or
 * FITNESS FOR A PARTICULAR PURPOSE.  See the GNU General Public License for
 * more details.
 *
 * You should have received a copy of the GNU General Public License along
 * with this program; if not, write to the Free Software Foundation, Inc.,
 * 51 Franklin Street, Fifth Floor, Boston, MA  02110-1301, USA.
 *
 */

/ {
	pinmux@70000868 {
		prod-settings {
			#prod-cells = <4>;
			prod {
				status = "okay";
				nvidia,prod-boot-init;
				prod = <0 0x28 0x0E0E0FF3 0x00605008
					0 0x2C 0x0E0E0FF3 0x00605008
					0 0x30 0x0E0E0FF3 0x00605008
					0 0x34 0x0E0E0FF3 0x00605008
					0 0x130 0x0E0E0FF3 0x00605008
					0 0x38 0x0E0E0FF3 0x0050500C
					0 0x18 0x0F003FF3 0x0029400C
					0 0xa8 0x0F003FF3 0x0029400C
					0 0x94 0x0E0E0FF3 0x0050500C
					0 0x00 0x0E0E0FF3 0x0050500C
					0 0x58 0x0E0E0FF3 0xF0000000
					0 0x5C 0x0E0E0FF3 0xF0000000
					0 0x0C 0x08080F33 0x03F37000
					0 0xbC 0x0E0E0FF3 0xF1717000
					0 0x50 0x0E0E0FF3 0xF1717000>;
			};
		};
	};
};
