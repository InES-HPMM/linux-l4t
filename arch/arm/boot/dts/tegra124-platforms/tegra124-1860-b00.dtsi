/ {
	i2c@7000c400 {
		pca9539_75: pca9546@75 {
			compatible = "nxp,pca9539";
			gpio-controller;
			#gpio-cells = <2>;
			reg = <0x75>;
			gpio-init-names = "default";
			gpio-init-0 = <&pca9539_default>;
			pca9539_default: default {
				 gpio-output-high = <0 3 4 5 7 13 14 15>;
			 };
		};
	};
};

