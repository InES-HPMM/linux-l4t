/*
 * tegra124-green-arrow-p2267-powertree-e1936-1000-a00.dtsi: Power tree
 *
 * Copyright (c) 2015, NVIDIA CORPORATION.  All rights reserved.
 *
 * This program is free software; you can redistribute it and/or modify
 * it under the terms of the GNU General Public License as published by
 * the Free Software Foundation; either version 2 of the License, or
 * (at your option) any later version.
 *
 * This program is distributed in the hope that it will be useful, but WITHOUT
 * ANY WARRANTY; without even the implied warranty of MERCHANTABILITY or
 * FITNESS FOR A PARTICULAR PURPOSE.  See the GNU General Public License for
 * more details.
 */

#include "tegra124-green-arrow-p2267-pmic-e1936-1000-a00.dtsi"
#include "tegra124-green-arrow-p2267-fixed-1936-1000-a00.dtsi"

/ {
};
