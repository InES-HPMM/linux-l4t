/ {
	regulators {
		compatible = "simple-bus";
		device_type = "fixed-regulators";
		#address-cells = <1>;
		#size-cells = <0>;

		vmmc: regulator@0 {
			compatible = "regulator-fixed";
			regulator-name = "vmmc-reg";
			regulator-min-microvolt = <3300000>;
			regulator-max-microvolt = <3300000>;
			regulator-always-on;

		};

	};
};
