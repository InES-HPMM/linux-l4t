/*
 * Copyright (c) 2014, NVIDIA CORPORATION.  All rights reserved.
 *
 * This program is free software; you can redistribute it and/or modify it
 * under the terms and conditions of the GNU General Public License,
 * version 2, as published by the Free Software Foundation.
 *
 * This program is distributed in the hope it will be useful, but WITHOUT
 * ANY WARRANTY; without even the implied warranty of MERCHANTABILITY or
 * FITNESS FOR A PARTICULAR PURPOSE.  See the GNU General Public License for
 * more details.
 */

#include "tegra124-thermal-fan-est.dtsi"

/ {
	thermal-fan-est {
		compatible = "loki-thermal-est";
		name = "thermal-fan-est";
		num_resources = <0>;
		shared_data = <&thermal_fan_est_shared_data>;
		trip_length = <10>;
		active_trip_temps = <0 60000 68000 79000 90000
				140000 150000 160000 170000 180000>;
		active_hysteresis = <0 20000 7000 10000 10000
				0 0 0 0 0>;
	};
};
