/*
 * tegra124-green-arrow-power-tree-p2267-e1936-1000-a00.dtsi
 *
 * Copyright (c) 2015, NVIDIA CORPORATION.  All rights reserved.
 *
 * This program is free software; you can redistribute it and/or modify
 * it under the terms of the GNU General Public License as published by
 * the Free Software Foundation; either version 2 of the License, or
 * (at your option) any later version.
 *
 * This program is distributed in the hope that it will be useful, but WITHOUT
 * ANY WARRANTY; without even the implied warranty of MERCHANTABILITY or
 * FITNESS FOR A PARTICULAR PURPOSE.  See the GNU General Public License for
 * more details.
 */

#include "tegra124-green-arrow-p2267-pmic-e1936-1000-a00.dtsi"
#include "tegra124-green-arrow-p2267-fixed-1936-1000-a00.dtsi"

/ {
	power-detect {
		pwrdet-nand-supply = <&palmas_smps8>;
		pwrdet-sdmmc1-supply = <&palmas_smps8>;
		pwrdet-sdmmc4-supply = <&palmas_smps8>;
		pwrdet-audio-supply = <&palmas_smps8>;
		pwrdet-uart-supply = <&palmas_smps8>;
		pwrdet-bb-supply = <&palmas_smps8>;
		pwrdet-mipi-supply = <&ldo5_reg>;
		pwrdet-sdmmc3-supply = <&palmas_ldo9>;
		pwrdet-hv-supply = <&ldoln_reg>;
		pwrdet-pex-ctl-supply = <&ldousb_reg>;
		pwrdet-cam-supply = <&en_vdd_cam_1v8>;
	};
};
