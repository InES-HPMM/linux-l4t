
/ {
	sysedp_batmon_calc {
		compatible = "nvidia,tegra124-sysedp_batmon_calc";
		ocv_lut = <
			100 4322580
			80  4084489
			60  3913651
			40  3795200
			20  3700276
			0   3500000
		>;
		ibat_lut = <
			600    9000
			(-600) 9000
			(-700) 0
		>;
		rbat_data = <
			75700
			75046
			75944
			78421
			83357
			98021
		>;
		temp_axis = <230>;
		capacity_axis = <100 80 60 40 20 0>;
		power_supply = "battery";
		r_const = <40000>;
		vsys_min = <3000000>;
	};
};
