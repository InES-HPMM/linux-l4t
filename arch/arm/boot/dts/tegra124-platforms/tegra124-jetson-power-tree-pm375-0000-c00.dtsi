#include "tegra124-platforms/tegra124-jetson_tk1-pmic-pm375-0000-c00-00.dtsi"
#include "tegra124-platforms/tegra124-jetson_tk1-fixed-pm375-0000-c00-00.dtsi"

/ {
	efuse@7000f800 {
		vpp_fuse-supply = <&as3722_ldo11>;
	};

	power-detect {
		pwrdet-pex-ctl-supply = <&as3722_sd4>;
		pwrdet-nand-supply = <&as3722_sd5>;
		pwrdet-sdmmc1-supply = <&as3722_sd5>;
		pwrdet-sdmmc4-supply = <&as3722_sd5>;
		pwrdet-audio-supply = <&as3722_sd5>;
		pwrdet-uart-supply = <&as3722_sd5>;
		pwrdet-bb-supply = <&as3722_sd5>;
		pwrdet-cam-supply = <&as3722_ldo1>;
		pwrdet-mipi-supply = <&as3722_ldo2>;
		pwrdet-sdmmc3-supply = <&as3722_ldo6>;
		pwrdet-hv-supply = <&as3722_gpio2_supply>;
	};
};
