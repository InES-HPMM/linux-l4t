#include "tegra124-platforms/tegra124-norrin-fixed-pm374-0000-a00.dtsi"
#include "tegra124-platforms/tegra124-norrin-pmic-pm374-0000-a00.dtsi"

/ {

        efuse@7000f800 {
                vpp_fuse-supply = <&as3722_ldo11>;
        };

        power-detect {
                pwrdet-nand-supply = <&as3722_sd5>;
                pwrdet-sdmmc1-supply = <&as3722_sd5>;
                pwrdet-sdmmc4-supply = <&as3722_sd5>;
                pwrdet-audio-supply = <&as3722_sd5>;
                pwrdet-uart-supply = <&as3722_sd5>;
                pwrdet-bb-supply = <&as3722_sd5>;
                pwrdet-cam-supply = <&as3722_ldo1>;
                pwrdet-mipi-supply = <&as3722_ldo2>;
                pwrdet-sdmmc3-supply = <&as3722_ldo6>;
                pwrdet-pex-ctl-supply = <&as3722_sd4>;
                pwrdet-hv-supply = <&as3722_gpio2>;
	}; 
	xusb@70090000 {
		usb_vbus0-supply = <&usb0_vbus>;
		usb_vbus1-supply = <&usb1_usb2_vbus>;
		usb_vbus2-supply = <&usb1_usb2_vbus>;
		hvdd_usb-supply = <&as3722_gpio2>;
		avdd_pll_utmip-supply = <&dcdc_1v8>;
		vddio_hsic-supply = <&as3722_ldo2>;
		avddio_usb-supply = <&as3722_sd4>;
	};
};
