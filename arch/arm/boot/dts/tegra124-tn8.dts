/dts-v1/;

#include "tegra124.dtsi"
#include "tegra124-platforms/tegra124-tn8-io.dtsi"
#include "tegra124-platforms/tegra124-tn8-dfll.dtsi"
#include "tegra124-platforms/tegra124-tn8-emc.dtsi"
#include "tegra124-platforms/tegra124-e1780-powermon.dtsi"
#include "tegra124-platforms/tegra124-tn8-e1736-pmic.dtsi"
#include "tegra124-platforms/tegra124-tn8-e1736-fixed.dtsi"
#include "tegra124-platforms/tegra124-e1780-gpio-default.dtsi"
#include "tegra124-platforms/tegra124-e1780-pinmux.dtsi"
#include "tegra124-platforms/tegra124-e1780-keys.dtsi"
#include "tegra124-platforms/tegra124-e1794-sensor.dtsi"

/ {
	model = "NVIDIA Tegra124 TN8";
	compatible = "nvidia,tn8", "nvidia,tegra124";
	nvidia,dtsfilename = __FILE__;
	nvidia,boardids = "1780:1100:2:B:7","1794:1000:0:A:6";
	#address-cells = <1>;
	#size-cells = <1>;

	chosen {
		bootargs = "tegraid=40.0.0.00.00 vmalloc=256M video=tegrafb console=ttyS0,115200n8 earlyprintk";
		linux,initrd-start = <0x85000000>;
		linux,initrd-end = <0x851bc400>;
	};

	i2c@7000c400 {
		pca9546@71 {
			vcc-supply = <&palmas_smps9>;
		};
	};
};

