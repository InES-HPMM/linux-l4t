#include "tegra124-loki-common.dtsi"
#include "tegra124-platforms/tegra124-loki-powermon-p2530-a01.dtsi"
#include "tegra124-platforms/tegra124-loki-pmic-e2530-0000-a01.dtsi"
#include "tegra124-platforms/tegra124-loki-fixed-e2530-0000-a00.dtsi"
#include "tegra124-platforms/tegra124-loki-gpio-pinmux-e2530.dtsi"

/ {
	nvidia,dtsfilename = __FILE__;
};
