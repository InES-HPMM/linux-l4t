/dts-v1/;

#include "tegra124.dtsi"
#include "tegra124-platforms/tegra124-bonaire-pinmux.dtsi"

/ {
	model = "NVIDIA Tegra124 Bonaire";
	compatible = "nvidia,bonaire", "nvidia,tegra124";
	nvidia,dtsfilename = __FILE__;


	chosen {
		bootargs = "tegraid=40.0.0.00.00 vmalloc=256M video=tegrafb console=ttyS0,115200n8 earlyprintk";
		linux,initrd-start = <0x85000000>;
		linux,initrd-end = <0x851bc400>;
	};

	memory@0x80000000 {
		#address-cells = <2>;
		#size-cells = <1>;
		device_type = "memory";
		reg = <0x80000000 0x20000000>;
	};

};
