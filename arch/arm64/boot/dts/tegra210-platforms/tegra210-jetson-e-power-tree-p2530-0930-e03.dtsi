/*
 * Copyright (c) 2014, NVIDIA CORPORATION.  All rights reserved.
 *
 * This program is free software; you can redistribute it and/or modify
 * it under the terms of the GNU General Public License as published by
 * the Free Software Foundation; either version 2 of the License, or
 * (at your option) any later version.
 *
 * This program is distributed in the hope that it will be useful, but WITHOUT
 * ANY WARRANTY; without even the implied warranty of MERCHANTABILITY or
 * FITNESS FOR A PARTICULAR PURPOSE.  See the GNU General Public License for
 * more details.
 *
 * You should have received a copy of the GNU General Public License along
 * along with this program. If not, see <http://www.gnu.org/licenses/>.
 */

#include "tegra210-jetson-common-power-tree-p2530-0930-e03.dtsi"

/ {
	power-detect {
		pwrdet-sys-supply = <&max77620_sd3>;
		pwrdet-uart-supply = <&max77620_sd3>;
		pwrdet-audio-supply = <&max77620_sd3>;
		pwrdet-cam-supply = <&max77620_sd3>;
		pwrdet-pex-ctrl-supply = <&max77620_sd3>;
		pwrdet-sdmmc1-supply = <&max77620_ldo2>;
		pwrdet-sdmmc3-supply = <&max77620_sd3>;
		pwrdet-sdmmc4-supply = <&max77620_sd3>;
		pwrdet-audio-hv-supply = <&max77620_sd3>;
		pwrdet-debug-supply = <&max77620_sd3>;
		pwrdet-dmic-supply = <&max77620_sd3>;
		pwrdet-gpio-supply = <&vdd_3v3>;
		pwrdet-spi-supply = <&max77620_sd3>;
		pwrdet-spi-hv-supply = <&max77620_sd3>;
		pwrdet-sdmmc2-supply = <&max77620_sd3>;
		pwrdet-dp-supply = <&max77620_sd3>;
	};
};
