/*
 * Copyright (c) 2015, NVIDIA CORPORATION.  All rights reserved.
 *
 * This program is free software; you can redistribute it and/or modify
 * it under the terms of the GNU General Public License as published by
 * the Free Software Foundation; either version 2 of the License, or
 * (at your option) any later version.
 *
 * This program is distributed in the hope that it will be useful, but WITHOUT
 * ANY WARRANTY; without even the implied warranty of MERCHANTABILITY or
 * FITNESS FOR A PARTICULAR PURPOSE.  See the GNU General Public License for
 * more details.
 *
 * You should have received a copy of the GNU General Public License along
 * with this program; if not, write to the Free Software Foundation, Inc.,
 * 51 Franklin Street, Fifth Floor, Boston, MA  02110-1301, USA.
 */

#include <dt-bindings/gpio/tegra-gpio.h>

/ {
	gpio: gpio@6000d000 {
		gpio-init-names = "default";
		gpio-init-0 = <&gpio_default>;

		gpio_default: default {
			gpio-input = <
				TEGRA_GPIO(E, 5)
				TEGRA_GPIO(F, 1)
				TEGRA_GPIO(S, 5)
				TEGRA_GPIO(S, 6)
				TEGRA_GPIO(T, 0)
				TEGRA_GPIO(T, 1)
				TEGRA_GPIO(A, 5)
				TEGRA_GPIO(X, 3)
				TEGRA_GPIO(X, 4)
				TEGRA_GPIO(X, 2)
				TEGRA_GPIO(X, 1)
				TEGRA_GPIO(X, 0)
				TEGRA_GPIO(X, 5)
				TEGRA_GPIO(X, 6)
				TEGRA_GPIO(Y, 0)
				TEGRA_GPIO(Y, 1)
				TEGRA_GPIO(Y, 2)
				TEGRA_GPIO(Z, 0)
				TEGRA_GPIO(K, 4)
				TEGRA_GPIO(L, 1)
				TEGRA_GPIO(H, 2)
				TEGRA_GPIO(H, 5)
				>;
			gpio-output-low = <
				>;
			gpio-output-high = <
				TEGRA_GPIO(S, 0)
				>;
		};
	};
};
