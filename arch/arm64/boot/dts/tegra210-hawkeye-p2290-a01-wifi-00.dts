/*
 * tegra210-hawkeye-p2290-a01-00.dts: Hawkeye P2290-A01 wifi sku.
 *
 * Copyright (c) 2015, NVIDIA CORPORATION.  All rights reserved.
 *
 * This program is free software; you can redistribute it and/or modify
 * it under the terms of the GNU General Public License as published by
 * the Free Software Foundation; version 2 of the License.
 *
 * This program is distributed in the hope that it will be useful, but WITHOUT
 * ANY WARRANTY; without even the implied warranty of MERCHANTABILITY or
 * FITNESS FOR A PARTICULAR PURPOSE.  See the GNU General Public License for
 * more details.
 */

#include "tegra210-hawkeye-p2290-a01-00.dts"

/ {
	nvidia,dtsfilename = __FILE__;

	i2c@7000d000 {
		max77620@3c {
			regulators {
				maxim,fps-source = <FPS_SRC_1>;
				/delete-property/ maxim,shutdown-fps-source;
			};
		};
	};
};
