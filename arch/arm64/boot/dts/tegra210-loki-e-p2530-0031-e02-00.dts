#include "tegra210-loki-e-p2530-0031-e01-00.dts"

/ {
	nvidia,dtsfilename = __FILE__;

	extcon {
		extcon@1 {
			extcon-adc-jack,states = <0x1    0     76
						  0x2    200   309
						  0x4    1049  1263
						  0x8    673   848
						  0x10   402   524>;
		};
	};
};
