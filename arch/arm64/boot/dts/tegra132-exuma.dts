/dts-v1/;

#include "tegra132.dtsi"

/ {
	model = "exuma_sim";
	compatible = "nvidia,exuma", "nvidia,tegra132";
	#address-cells = <2>;
	#size-cells = <2>;

	/* chosen */

	memory@80000000 {
		device_type = "memory";
		reg = < 0x0 0x80000000 0x0 0x40000000 >;
	};
};
